/dts-v1/;

/ {

	__fixups__ {
		accdet = "/fragment@11:target:0";
		afe = "/fragment@21/__overlay__:mediatek,platform:0";
		auxadc = "/fragment@30:target:0", "/fragment@31/__overlay__:io-channels:0";
		bat_gm30 = "/fragment@29:target:0";
		charger = "/fragment@5:target:0";
		chosen = "/fragment@0:target:0";
		dispsys_config = "/fragment@9:target:0";
		dsi0 = "/fragment@10:target:0";
		dsi_te = "/fragment@51:target:0";
		goodix_fp = "/fragment@25:target:0", "/fragment@49:target:0";
		gpio = "/fragment@44:target:0";
		gpio_usage_mapping = "/fragment@43:target:0";
		gps = "/fragment@14:target:0";
		i2c0 = "/fragment@33:target:0";
		i2c1 = "/fragment@34:target:0";
		i2c2 = "/fragment@20:target:0", "/fragment@35:target:0";
		i2c3 = "/fragment@36:target:0";
		i2c4 = "/fragment@37:target:0";
		i2c5 = "/fragment@38:target:0";
		i2c6 = "/fragment@22:target:0", "/fragment@39:target:0";
		i2c7 = "/fragment@6:target:0", "/fragment@40:target:0";
		i2c8 = "/fragment@41:target:0";
		i2c9 = "/fragment@42:target:0";
		irq_nfc = "/fragment@46:target:0";
		kd_camera_hw1 = "/fragment@19:target:0", "/fragment@55:target:0";
		keypad = "/fragment@57:target:0";
		lk_charger = "/fragment@4:target:0";
		md1_sim1_hot_plug_eint = "/fragment@52:target:0";
		md_auxadc = "/fragment@31:target:0";
		mrdump_ext_rst = "/fragment@45:target:0";
		msdc1 = "/fragment@17:target:0";
		mt6359_snd = "/fragment@21/__overlay__:mediatek,audio-codec:0";
		mt6360_pmic = "/fragment@2:target:0";
		mt6360_pmu = "/fragment@1:target:0";
		mt6360_typec = "/fragment@3:target:0";
		mt_pmic_vcamio_ldo_reg = "/fragment@19/__overlay__:cam0_vcamio-supply:0", "/fragment@19/__overlay__:cam1_vcamio-supply:0", "/fragment@19/__overlay__:cam2_vcamio-supply:0", "/fragment@19/__overlay__:cam3_vcamio-supply:0", "/fragment@53:target:0";
		mt_pmic_vfp_ldo_reg = "/fragment@25/__overlay__:vfingerprint-supply:0";
		mt_pmic_vtp_ldo_reg = "/fragment@54:target:0", "/fragment@56/__overlay__:vtouch-supply:0";
		mtkfb = "/fragment@8:target:0";
		nfc = "/fragment@23:target:0";
		odm = "/fragment@12:target:0";
		pio = "/fragment@1/__overlay__:mt6360,intr_gpio:0", "/fragment@3/__overlay__:mt6360pd,intr_gpio:0", "/fragment@6/__overlay__/sgm4151x@6b:gpio_sgm4151x_en:0", "/fragment@7:target:0", "/fragment@10/__overlay__/panel1@0:pm-enable-gpios:0", "/fragment@10/__overlay__/panel1@0:reset-gpios:0", "/fragment@10/__overlay__/panel1@0:bias-gpios:0", "/fragment@10/__overlay__/panel1@0:bias-gpios:12", "/fragment@10/__overlay__/panel2@0:pm-enable-gpios:0", "/fragment@10/__overlay__/panel2@0:reset-gpios:0", "/fragment@10/__overlay__/panel2@0:bias-gpios:0", "/fragment@10/__overlay__/panel2@0:bias-gpios:12", "/fragment@10/__overlay__/panel3@0:pm-enable-gpios:0", "/fragment@10/__overlay__/panel3@0:reset-gpios:0", "/fragment@10/__overlay__/panel3@0:bias-gpios:0", "/fragment@10/__overlay__/panel3@0:bias-gpios:12", "/fragment@11/__overlay__:gpio_mic_switch_pin:0", "/fragment@11/__overlay__:gpio_headset_usb_switch_pin:0", "/fragment@13:target:0", "/fragment@16:target:0", "/fragment@17/__overlay__:cd-gpios:0", "/fragment@18:target:0", "/fragment@22/__overlay__/aw881xx_smartpa@34:reset-gpio:0", "/fragment@22/__overlay__/aw881xx_smartpa@34:irq-gpio:0", "/fragment@23/__overlay__:gpio-rst-std:0", "/fragment@23/__overlay__:gpio-irq-std:0", "/fragment@25/__overlay__:fingeer_eint_pin_std:0", "/fragment@26:target:0", "/fragment@27:target:0", "/fragment@28/__overlay__:reportkey_eint_pin:0", "/fragment@43/__overlay__:GPIO_FDD_BAND_SUPPORT_DETECT_1ST_PIN:0", "/fragment@43/__overlay__:GPIO_FDD_BAND_SUPPORT_DETECT_2ND_PIN:0", "/fragment@43/__overlay__:GPIO_FDD_BAND_SUPPORT_DETECT_3RD_PIN:0", "/fragment@43/__overlay__:GPIO_SIM1_HOT_PLUG:0", "/fragment@43/__overlay__:GPIO_SIM2_SCLK:0", "/fragment@43/__overlay__:GPIO_SIM2_SRST:0", "/fragment@43/__overlay__:GPIO_SIM2_SIO:0", "/fragment@43/__overlay__:GPIO_SIM1_SIO:0", "/fragment@43/__overlay__:GPIO_SIM1_SRST:0", "/fragment@43/__overlay__:GPIO_SIM1_SCLK:0", "/fragment@43/__overlay__:GPIO_RF_PWREN_RST_PIN:0", "/fragment@45/__overlay__:interrupt-parent:0", "/fragment@45/__overlay__:deb-gpios:0", "/fragment@46/__overlay__:interrupt-parent:0", "/fragment@47/__overlay__:interrupt-parent:0", "/fragment@48/__overlay__:interrupt-parent:0", "/fragment@49/__overlay__:interrupt-parent:0", "/fragment@50/__overlay__:interrupt-parent:0", "/fragment@51/__overlay__:interrupt-parent:0";
		pmic_clock_buffer_ctrl = "/fragment@32:target:0";
		reportkey = "/fragment@28:target:0", "/fragment@50:target:0";
		sound = "/fragment@21:target:0";
		spi5 = "/fragment@24:target:0";
		subpmic_pmu_eint = "/fragment@47:target:0";
		touch = "/fragment@15:target:0", "/fragment@48:target:0", "/fragment@56:target:0";
	};

	__local_fixups__ {

		fragment@10 {

			__overlay__ {

				panel1@0 {

					port {

						endpoint {
							remote-endpoint = <0x0>;
						};
					};
				};

				panel2@0 {

					port {

						endpoint {
							remote-endpoint = <0x0>;
						};
					};
				};

				panel3@0 {

					port {

						endpoint {
							remote-endpoint = <0x0>;
						};
					};
				};

				ports {

					port {

						endpoint {
							remote-endpoint = <0x0>;
						};
					};
				};
			};
		};

		fragment@14 {

			__overlay__ {
				pinctrl-0 = <0x0>;
				pinctrl-1 = <0x0>;
				pinctrl-2 = <0x0>;
				pinctrl-3 = <0x0>;
				pinctrl-4 = <0x0>;
				pinctrl-5 = <0x0>;
				pinctrl-6 = <0x0>;
			};
		};

		fragment@15 {

			__overlay__ {
				pinctrl-0 = <0x0>;
				pinctrl-1 = <0x0>;
				pinctrl-2 = <0x0>;
				pinctrl-3 = <0x0>;
				pinctrl-4 = <0x0>;
				pinctrl-5 = <0x0>;
			};
		};

		fragment@19 {

			__overlay__ {
				pinctrl-0 = <0x0>;
				pinctrl-1 = <0x0>;
				pinctrl-10 = <0x0>;
				pinctrl-11 = <0x0>;
				pinctrl-12 = <0x0>;
				pinctrl-13 = <0x0>;
				pinctrl-14 = <0x0>;
				pinctrl-15 = <0x0>;
				pinctrl-16 = <0x0>;
				pinctrl-17 = <0x0>;
				pinctrl-18 = <0x0>;
				pinctrl-19 = <0x0>;
				pinctrl-2 = <0x0>;
				pinctrl-20 = <0x0>;
				pinctrl-21 = <0x0>;
				pinctrl-22 = <0x0>;
				pinctrl-23 = <0x0>;
				pinctrl-24 = <0x0>;
				pinctrl-25 = <0x0>;
				pinctrl-26 = <0x0>;
				pinctrl-27 = <0x0>;
				pinctrl-28 = <0x0>;
				pinctrl-29 = <0x0>;
				pinctrl-3 = <0x0>;
				pinctrl-30 = <0x0>;
				pinctrl-31 = <0x0>;
				pinctrl-32 = <0x0>;
				pinctrl-33 = <0x0>;
				pinctrl-34 = <0x0>;
				pinctrl-35 = <0x0>;
				pinctrl-36 = <0x0>;
				pinctrl-37 = <0x0>;
				pinctrl-38 = <0x0>;
				pinctrl-39 = <0x0>;
				pinctrl-4 = <0x0>;
				pinctrl-40 = <0x0>;
				pinctrl-41 = <0x0>;
				pinctrl-42 = <0x0>;
				pinctrl-43 = <0x0>;
				pinctrl-44 = <0x0>;
				pinctrl-45 = <0x0>;
				pinctrl-46 = <0x0>;
				pinctrl-47 = <0x0>;
				pinctrl-48 = <0x0>;
				pinctrl-49 = <0x0>;
				pinctrl-5 = <0x0>;
				pinctrl-50 = <0x0>;
				pinctrl-51 = <0x0>;
				pinctrl-52 = <0x0>;
				pinctrl-53 = <0x0>;
				pinctrl-54 = <0x0>;
				pinctrl-55 = <0x0>;
				pinctrl-56 = <0x0>;
				pinctrl-57 = <0x0>;
				pinctrl-58 = <0x0>;
				pinctrl-6 = <0x0>;
				pinctrl-7 = <0x0>;
				pinctrl-8 = <0x0>;
				pinctrl-9 = <0x0>;
			};
		};

		fragment@21 {

			__overlay__ {

				mediatek,speaker-codec {
					sound-dai = <0x0>;
				};
			};
		};

		fragment@25 {

			__overlay__ {
				pinctrl-0 = <0x0>;
				pinctrl-1 = <0x0>;
				pinctrl-2 = <0x0>;
				pinctrl-3 = <0x0>;
				pinctrl-4 = <0x0>;
				pinctrl-5 = <0x0>;
				pinctrl-6 = <0x0>;
				pinctrl-7 = <0x0>;
			};
		};

		fragment@28 {

			__overlay__ {
				pinctrl-0 = <0x0>;
				pinctrl-1 = <0x0>;
			};
		};

		fragment@8 {

			__overlay__ {
				pinctrl-0 = <0x0>;
				pinctrl-1 = <0x0>;
				pinctrl-2 = <0x0>;
				pinctrl-3 = <0x0>;
				pinctrl-4 = <0x0>;
				pinctrl-5 = <0x0>;
				pinctrl-6 = <0x0>;
			};
		};

		fragment@9 {

			__overlay__ {
				pinctrl-0 = <0x0>;
				pinctrl-1 = <0x0>;
				pinctrl-2 = <0x0>;
			};
		};
	};

	__symbols__ {
		aw881xx_smartpa = "/fragment@22/__overlay__/aw881xx_smartpa@34";
		camera_main_af_mtk = "/fragment@35/__overlay__/camera_main_af@72";
		camera_main_mtk = "/fragment@35/__overlay__/camera_main@3a";
		camera_main_two_af_mtk = "/fragment@41/__overlay__/camera_main_two_af@0c";
		camera_main_two_mtk = "/fragment@41/__overlay__/camera_main_two@10";
		camera_pins_cam0_mclk_2ma = "/fragment@18/__overlay__/camera_pins_cam0_mclk_2ma";
		camera_pins_cam0_mclk_4ma = "/fragment@18/__overlay__/camera_pins_cam0_mclk_4ma";
		camera_pins_cam0_mclk_6ma = "/fragment@18/__overlay__/camera_pins_cam0_mclk_6ma";
		camera_pins_cam0_mclk_8ma = "/fragment@18/__overlay__/camera_pins_cam0_mclk_8ma";
		camera_pins_cam0_mclk_off = "/fragment@18/__overlay__/camera_pins_cam0_mclk_off";
		camera_pins_cam0_pnd_0 = "/fragment@18/__overlay__/cam0@2";
		camera_pins_cam0_pnd_1 = "/fragment@18/__overlay__/cam0@3";
		camera_pins_cam0_rst_0 = "/fragment@18/__overlay__/cam0@0";
		camera_pins_cam0_rst_1 = "/fragment@18/__overlay__/cam0@1";
		camera_pins_cam0_vcama_0 = "/fragment@18/__overlay__/cam0@vcam2";
		camera_pins_cam0_vcama_1 = "/fragment@18/__overlay__/cam0@vcam3";
		camera_pins_cam0_vcamd_0 = "/fragment@18/__overlay__/cam0@vcam0";
		camera_pins_cam0_vcamd_1 = "/fragment@18/__overlay__/cam0@vcam1";
		camera_pins_cam1_mclk_2ma = "/fragment@18/__overlay__/camera_pins_cam1_mclk_2ma";
		camera_pins_cam1_mclk_4ma = "/fragment@18/__overlay__/camera_pins_cam1_mclk_4ma";
		camera_pins_cam1_mclk_6ma = "/fragment@18/__overlay__/camera_pins_cam1_mclk_6ma";
		camera_pins_cam1_mclk_8ma = "/fragment@18/__overlay__/camera_pins_cam1_mclk_8ma";
		camera_pins_cam1_mclk_off = "/fragment@18/__overlay__/camera_pins_cam1_mclk_off";
		camera_pins_cam1_pnd_0 = "/fragment@18/__overlay__/cam1@2";
		camera_pins_cam1_pnd_1 = "/fragment@18/__overlay__/cam1@3";
		camera_pins_cam1_rst_0 = "/fragment@18/__overlay__/cam1@0";
		camera_pins_cam1_rst_1 = "/fragment@18/__overlay__/cam1@1";
		camera_pins_cam1_vcama_0 = "/fragment@18/__overlay__/cam1@vcam2";
		camera_pins_cam1_vcama_1 = "/fragment@18/__overlay__/cam1@vcam3";
		camera_pins_cam1_vcamd_0 = "/fragment@18/__overlay__/cam1@vcam0";
		camera_pins_cam1_vcamd_1 = "/fragment@18/__overlay__/cam1@vcam1";
		camera_pins_cam2_mclk_2ma = "/fragment@18/__overlay__/camera_pins_cam2_mclk_2ma";
		camera_pins_cam2_mclk_4ma = "/fragment@18/__overlay__/camera_pins_cam2_mclk_4ma";
		camera_pins_cam2_mclk_6ma = "/fragment@18/__overlay__/camera_pins_cam2_mclk_6ma";
		camera_pins_cam2_mclk_8ma = "/fragment@18/__overlay__/camera_pins_cam2_mclk_8ma";
		camera_pins_cam2_mclk_off = "/fragment@18/__overlay__/camera_pins_cam2_mclk_off";
		camera_pins_cam2_pnd_0 = "/fragment@18/__overlay__/cam2@2";
		camera_pins_cam2_pnd_1 = "/fragment@18/__overlay__/cam2@3";
		camera_pins_cam2_rst_0 = "/fragment@18/__overlay__/cam2@0";
		camera_pins_cam2_rst_1 = "/fragment@18/__overlay__/cam2@1";
		camera_pins_cam2_vcama_0 = "/fragment@18/__overlay__/cam2@vcam2";
		camera_pins_cam2_vcama_1 = "/fragment@18/__overlay__/cam2@vcam3";
		camera_pins_cam2_vcamd_0 = "/fragment@18/__overlay__/cam2@vcam0";
		camera_pins_cam2_vcamd_1 = "/fragment@18/__overlay__/cam2@vcam1";
		camera_pins_cam3_mclk_2ma = "/fragment@18/__overlay__/camera_pins_cam3_mclk_2ma";
		camera_pins_cam3_mclk_4ma = "/fragment@18/__overlay__/camera_pins_cam3_mclk_4ma";
		camera_pins_cam3_mclk_6ma = "/fragment@18/__overlay__/camera_pins_cam3_mclk_6ma";
		camera_pins_cam3_mclk_8ma = "/fragment@18/__overlay__/camera_pins_cam3_mclk_8ma";
		camera_pins_cam3_mclk_off = "/fragment@18/__overlay__/camera_pins_cam3_mclk_off";
		camera_pins_cam3_pnd_0 = "/fragment@18/__overlay__/cam3@2";
		camera_pins_cam3_pnd_1 = "/fragment@18/__overlay__/cam3@3";
		camera_pins_cam3_rst_0 = "/fragment@18/__overlay__/cam3@0";
		camera_pins_cam3_rst_1 = "/fragment@18/__overlay__/cam3@1";
		camera_pins_cam3_vcama_0 = "/fragment@18/__overlay__/cam3@vcam2";
		camera_pins_cam3_vcama_1 = "/fragment@18/__overlay__/cam3@vcam3";
		camera_pins_cam3_vcamd_0 = "/fragment@18/__overlay__/cam3@vcam0";
		camera_pins_cam3_vcamd_1 = "/fragment@18/__overlay__/cam3@vcam1";
		camera_pins_cam_af0 = "/fragment@18/__overlay__/camaf@0";
		camera_pins_cam_af1 = "/fragment@18/__overlay__/camaf@1";
		camera_pins_cam_mipi_switch_en_0 = "/fragment@18/__overlay__/mipi_en@0";
		camera_pins_cam_mipi_switch_en_1 = "/fragment@18/__overlay__/mipi_en@1";
		camera_pins_cam_mipi_switch_sel_0 = "/fragment@18/__overlay__/mipi_sel@0";
		camera_pins_cam_mipi_switch_sel_1 = "/fragment@18/__overlay__/mipi_sel@1";
		camera_pins_default = "/fragment@18/__overlay__/camdefault";
		camera_sub_mtk = "/fragment@37/__overlay__/camera_sub@2a";
		camera_sub_two_af_mtk = "/fragment@37/__overlay__/camera_sub_two_af@1c";
		camera_sub_two_mtk = "/fragment@37/__overlay__/camera_sub_two@20";
		cap_touch_mtk = "/fragment@33/__overlay__/cap_touch@5d";
		ctp_pins_default = "/fragment@16/__overlay__/eint0default";
		ctp_pins_eint_as_int = "/fragment@16/__overlay__/eint@0";
		ctp_pins_eint_output0 = "/fragment@16/__overlay__/eintoutput0";
		ctp_pins_eint_output1 = "/fragment@16/__overlay__/eintoutput1";
		ctp_pins_rst_output0 = "/fragment@16/__overlay__/rstoutput0";
		ctp_pins_rst_output1 = "/fragment@16/__overlay__/rstoutput1";
		dsi_out = "/fragment@10/__overlay__/ports/port/endpoint";
		fingerprint_default = "/fragment@26/__overlay__/state_default";
		fingerprint_eint = "/fragment@26/__overlay__/state_spi_eint_init";
		fingerprint_reset_high = "/fragment@26/__overlay__/state_spi_rst_high";
		fingerprint_reset_low = "/fragment@26/__overlay__/state_spi_rst_low";
		fingerprint_spi_clk = "/fragment@26/__overlay__/state_spi_ck_init";
		fingerprint_spi_cs = "/fragment@26/__overlay__/state_spi_cs_init";
		fingerprint_spi_mi = "/fragment@26/__overlay__/state_spi_miso_init";
		fingerprint_spi_mo = "/fragment@26/__overlay__/state_spi_mosi_init";
		gps_l1_lna_pins_dsp_ctrl = "/fragment@13/__overlay__/gps_l1_lna@1";
		gps_l1_lna_pins_oh = "/fragment@13/__overlay__/gps_l1_lna@2";
		gps_l1_lna_pins_ol = "/fragment@13/__overlay__/gps_l1_lna@0";
		gps_l5_lna_pins_dsp_ctrl = "/fragment@13/__overlay__/gps_l5_lna@1";
		gps_l5_lna_pins_oh = "/fragment@13/__overlay__/gps_l5_lna@2";
		gps_l5_lna_pins_ol = "/fragment@13/__overlay__/gps_l5_lna@0";
		gps_pins_default = "/fragment@13/__overlay__/gps_default";
		i2c_lcd_bias_mtk = "/fragment@39/__overlay__/i2c_lcd_bias@3e";
		led0 = "/fragment@12/__overlay__/led@0";
		led1 = "/fragment@12/__overlay__/led@1";
		led2 = "/fragment@12/__overlay__/led@2";
		led3 = "/fragment@12/__overlay__/led@3";
		led4 = "/fragment@12/__overlay__/led@4";
		led5 = "/fragment@12/__overlay__/led@5";
		led6 = "/fragment@12/__overlay__/led@6";
		mtk_camera_eeprom0 = "/fragment@20/__overlay__/camera_eeprom0@50";
		mtkfb_pins_lcd_bias_enn0 = "/fragment@7/__overlay__/lcd_bias_enn0_gpio";
		mtkfb_pins_lcd_bias_enn1 = "/fragment@7/__overlay__/lcd_bias_enn1_gpio";
		mtkfb_pins_lcd_bias_enp0 = "/fragment@7/__overlay__/lcd_bias_enp0_gpio";
		mtkfb_pins_lcd_bias_enp1 = "/fragment@7/__overlay__/lcd_bias_enp1_gpio";
		mtkfb_pins_lcm_dsi_te = "/fragment@7/__overlay__/lcm_dsi_te";
		mtkfb_pins_lcm_rst_out0_gpio = "/fragment@7/__overlay__/lcm_rst_out0_gpio";
		mtkfb_pins_lcm_rst_out1_gpio = "/fragment@7/__overlay__/lcm_rst_out1_gpio";
		nfc_mtk = "/fragment@36/__overlay__/nfc@08";
		panel_in1 = "/fragment@10/__overlay__/panel1@0/port/endpoint";
		panel_in2 = "/fragment@10/__overlay__/panel2@0/port/endpoint";
		panel_in3 = "/fragment@10/__overlay__/panel3@0/port/endpoint";
		reportkey_pins_default = "/fragment@27/__overlay__/pins_default";
		reportkey_pins_eint_as_int = "/fragment@27/__overlay__/pins_cfg";
		subpmic_ldo_mtk = "/fragment@38/__overlay__/subpmic_ldo@64";
		subpmic_mtk = "/fragment@38/__overlay__/subpmic@34";
		subpmic_pmic_mtk = "/fragment@38/__overlay__/subpmic_pmic@1a";
		usb_type_c_mtk = "/fragment@38/__overlay__/usb_type_c@4e";
		vibrator0 = "/fragment@12/__overlay__/vibrator@0";
	};

	fragment@0 {
		target = <0xffffffff>;

		__overlay__ {
			atag,videolfb-fb_base_h = <0x0>;
			atag,videolfb-fb_base_l = "~`P";
			atag,videolfb-fps = <0x1770>;
			atag,videolfb-islcm_inited = <0x0>;
			atag,videolfb-islcmfound = <0x1>;
			atag,videolfb-lcmname = "nt35595_fhd_dsi_cmd_truly_nt50358_drv";
			atag,videolfb-vramSize = <0x1be0000>;
		};
	};

	fragment@1 {
		target = <0xffffffff>;

		__overlay__ {
			mt6360,intr_gpio = <0xffffffff 0xa 0x0>;
			mt6360,intr_gpio_num = <0xa>;

			rgbled {
				mt,led_name = "red", "blue", "green", "mt6360_pmu_led4";
			};
		};
	};

	fragment@10 {
		target = <0xffffffff>;

		__overlay__ {
			#address-cells = <0x1>;
			#size-cells = <0x0>;
			status = "okay";

			panel1@0 {
				bias-gpios = <0xffffffff 0x89 0x0 0xffffffff 0x8a 0x0>;
				compatible = "dezhixin,ili9882n,vdo";
				pinctrl-names = "default";
				pm-enable-gpios = <0xffffffff 0x88 0x0>;
				reg = <0x0>;
				reset-gpios = <0xffffffff 0x56 0x0>;

				port {

					endpoint {
						phandle = <0x9>;
						remote-endpoint = <0x8>;
					};
				};
			};

			panel2@0 {
				bias-gpios = <0xffffffff 0x89 0x0 0xffffffff 0x8a 0x0>;
				compatible = "helitai,ili9882n,vdo";
				pinctrl-names = "default";
				pm-enable-gpios = <0xffffffff 0x88 0x0>;
				reg = <0x1>;
				reset-gpios = <0xffffffff 0x56 0x0>;

				port {

					endpoint {
						phandle = <0x5d>;
						remote-endpoint = <0x8>;
					};
				};
			};

			panel3@0 {
				bias-gpios = <0xffffffff 0x89 0x0 0xffffffff 0x8a 0x0>;
				compatible = "truly,ft8756,vdo";
				pinctrl-names = "default";
				pm-enable-gpios = <0xffffffff 0x88 0x0>;
				reg = <0x2>;
				reset-gpios = <0xffffffff 0x56 0x0>;

				port {

					endpoint {
						phandle = <0x5e>;
						remote-endpoint = <0x8>;
					};
				};
			};

			ports {

				port {

					endpoint {
						phandle = <0x8>;
						remote-endpoint = <0x9>;
					};
				};
			};
		};
	};

	fragment@11 {
		target = <0xffffffff>;

		__overlay__ {
			accdet-mic-mode = <0x2>;
			accdet-mic-vol = <0x8>;
			accdet-plugout-debounce = <0x1>;
			eint_use_ext_res = <0x0>;
			gpio_headset_usb_switch_pin = <0xffffffff 0x18 0x0>;
			gpio_mic_switch_pin = <0xffffffff 0x17 0x0>;
			headset-four-key-threshold = <0x0 0x3a 0x79 0xc0 0x190>;
			headset-mode-setting = <0x500 0x500 0x1 0x1f0 0x800 0x800 0x20 0x44 0x4 0x1 0x5 0x3 0x3 0x5 0xe>;
			headset-three-key-threshold = <0x0 0x50 0xdc 0x190>;
			headset-three-key-threshold-CDD = <0x0 0x79 0xc0 0x258>;
			status = "okay";
		};
	};

	fragment@12 {
		target = <0xffffffff>;

		__overlay__ {

			led@0 {
				compatible = "mediatek,red";
				data = <0x1>;
				led_mode = <0x0>;
				phandle = <0x5f>;
				pwm_config = <0x0 0x0 0x0 0x0 0x0>;
			};

			led@1 {
				compatible = "mediatek,green";
				data = <0x1>;
				led_mode = <0x0>;
				phandle = <0x60>;
				pwm_config = <0x0 0x0 0x0 0x0 0x0>;
			};

			led@2 {
				compatible = "mediatek,blue";
				data = <0x1>;
				led_mode = <0x0>;
				phandle = <0x61>;
				pwm_config = <0x0 0x0 0x0 0x0 0x0>;
			};

			led@3 {
				compatible = "mediatek,jogball-backlight";
				data = <0x1>;
				led_mode = <0x0>;
				phandle = <0x62>;
				pwm_config = <0x0 0x0 0x0 0x0 0x0>;
			};

			led@4 {
				compatible = "mediatek,keyboard-backlight";
				data = <0x1>;
				led_mode = <0x0>;
				phandle = <0x63>;
				pwm_config = <0x0 0x0 0x0 0x0 0x0>;
			};

			led@5 {
				compatible = "mediatek,button-backlight";
				data = <0x1>;
				led_mode = <0x0>;
				phandle = <0x64>;
				pwm_config = <0x0 0x0 0x0 0x0 0x0>;
			};

			led@6 {
				compatible = "mediatek,lcd-backlight";
				data = <0x1>;
				led_mode = <0x5>;
				phandle = <0x65>;
				pwm_config = <0x0 0x1 0x0 0x0 0x0>;
			};

			vibrator@0 {
				compatible = "mediatek,vibrator";
				phandle = <0x66>;
				vib_limit = <0x9>;
				vib_timer = <0x19>;
				vib_vol = <0x5>;
			};
		};
	};

	fragment@13 {
		target = <0xffffffff>;

		__overlay__ {

			gps_default {
				phandle = <0xa>;
			};

			gps_l1_lna@0 {
				phandle = <0xb>;

				pins_cmd_dat {
					output-low;
					pinmux = <0x5700>;
				};
			};

			gps_l1_lna@1 {
				phandle = <0xc>;

				pins_cmd_dat {
					pinmux = <0x5702>;
				};
			};

			gps_l1_lna@2 {
				phandle = <0xd>;

				pins_cmd_dat {
					output-high;
					pinmux = <0x5700>;
				};
			};

			gps_l5_lna@0 {
				phandle = <0xe>;

				pins_cmd_dat {
					output-low;
					pinmux = <0x5b00>;
				};
			};

			gps_l5_lna@1 {
				phandle = <0xf>;

				pins_cmd_dat {
					pinmux = <0x5b04>;
				};
			};

			gps_l5_lna@2 {
				phandle = <0x10>;

				pins_cmd_dat {
					output-high;
					pinmux = <0x5b00>;
				};
			};
		};
	};

	fragment@14 {
		target = <0xffffffff>;

		__overlay__ {
			pinctrl-0 = <0xa>;
			pinctrl-1 = <0xb>;
			pinctrl-2 = <0xc>;
			pinctrl-3 = <0xd>;
			pinctrl-4 = <0xe>;
			pinctrl-5 = <0xf>;
			pinctrl-6 = <0x10>;
			pinctrl-names = "default", "gps_l1_lna_disable", "gps_l1_lna_dsp_ctrl", "gps_l1_lna_enable", "gps_l5_lna_disable", "gps_l5_lna_dsp_ctrl", "gps_l5_lna_enable";
			status = "okay";
		};
	};

	fragment@15 {
		target = <0xffffffff>;

		__overlay__ {
			pinctrl-0 = <0x11>;
			pinctrl-1 = <0x12>;
			pinctrl-2 = <0x13>;
			pinctrl-3 = <0x14>;
			pinctrl-4 = <0x15>;
			pinctrl-5 = <0x16>;
			pinctrl-names = "default", "state_eint_as_int", "state_eint_output0", "state_eint_output1", "state_rst_output0", "state_rst_output1";
			status = "okay";
			tpd-filter-custom-prameters = <0x0 0x0 0x0 0x0 0x0 0x0 0x0 0x0 0x0 0x0 0x0 0x0>;
			tpd-filter-custom-speed = <0x0 0x0 0x0>;
			tpd-filter-enable = <0x0>;
			tpd-filter-pixel-density = <0x92>;
			tpd-key-dim-local = <0x5a 0x373 0x64 0x28 0xe6 0x373 0x64 0x28 0x172 0x373 0x64 0x28 0x0 0x0 0x0 0x0>;
			tpd-key-local = <0x8b 0xac 0x9e 0x0>;
			tpd-key-num = <0x3>;
			tpd-max-touch-num = <0x5>;
			tpd-resolution = <0x2d0 0x640>;
			use-tpd-button = <0x0>;
		};
	};

	fragment@16 {
		target = <0xffffffff>;

		__overlay__ {

			eint0default {
				phandle = <0x11>;
			};

			eint@0 {
				phandle = <0x12>;

				pins_cmd_dat {
					bias-disable;
					pinmux = <0xe00>;
					slew-rate = <0x0>;
				};
			};

			eintoutput0 {
				phandle = <0x13>;

				pins_cmd_dat {
					output-low;
					pinmux = <0xe00>;
					slew-rate = <0x1>;
				};
			};

			eintoutput1 {
				phandle = <0x14>;

				pins_cmd_dat {
					output-high;
					pinmux = <0xe00>;
					slew-rate = <0x1>;
				};
			};

			rstoutput0 {
				phandle = <0x15>;

				pins_cmd_dat {
					output-low;
					pinmux = <0xf00>;
					slew-rate = <0x1>;
				};
			};

			rstoutput1 {
				phandle = <0x16>;

				pins_cmd_dat {
					output-high;
					pinmux = <0xf00>;
					slew-rate = <0x1>;
				};
			};
		};
	};

	fragment@17 {
		target = <0xffffffff>;

		__overlay__ {
			cd-gpios = <0xffffffff 0x4 0x0>;
			cd_level = [01];
		};
	};

	fragment@18 {
		target = <0xffffffff>;

		__overlay__ {

			cam0@0 {
				phandle = <0x18>;

				pins_cmd_dat {
					output-low;
					pinmux = <0x3600>;
					slew-rate = <0x1>;
				};
			};

			cam0@1 {
				phandle = <0x19>;

				pins_cmd_dat {
					output-high;
					pinmux = <0x3600>;
					slew-rate = <0x1>;
				};
			};

			cam0@2 {
				phandle = <0x1a>;

				pins_cmd_dat {
					output-low;
					pinmux = <0x3500>;
					slew-rate = <0x1>;
				};
			};

			cam0@3 {
				phandle = <0x1b>;

				pins_cmd_dat {
					output-high;
					pinmux = <0x3500>;
					slew-rate = <0x1>;
				};
			};

			cam0@vcam0 {
				phandle = <0x28>;

				pins_cmd_dat {
					output-low;
					pinmux = <0x8300>;
					slew-rate = <0x1>;
				};
			};

			cam0@vcam1 {
				phandle = <0x29>;

				pins_cmd_dat {
					output-high;
					pinmux = <0x8300>;
					slew-rate = <0x1>;
				};
			};

			cam0@vcam2 {
				phandle = <0x2a>;

				pins_cmd_dat {
					output-low;
					pinmux = <0x1300>;
					slew-rate = <0x1>;
				};
			};

			cam0@vcam3 {
				phandle = <0x2b>;

				pins_cmd_dat {
					output-high;
					pinmux = <0x1300>;
					slew-rate = <0x1>;
				};
			};

			cam1@0 {
				phandle = <0x1c>;

				pins_cmd_dat {
					output-low;
					pinmux = <0x3c00>;
					slew-rate = <0x1>;
				};
			};

			cam1@1 {
				phandle = <0x1d>;

				pins_cmd_dat {
					output-high;
					pinmux = <0x3c00>;
					slew-rate = <0x1>;
				};
			};

			cam1@2 {
				phandle = <0x1e>;

				pins_cmd_dat {
					output-low;
					pinmux = <0x3b00>;
					slew-rate = <0x1>;
				};
			};

			cam1@3 {
				phandle = <0x1f>;

				pins_cmd_dat {
					output-high;
					pinmux = <0x3b00>;
					slew-rate = <0x1>;
				};
			};

			cam1@vcam0 {
				phandle = <0x2c>;

				pins_cmd_dat {
					output-low;
					pinmux = <0x1000>;
					slew-rate = <0x1>;
				};
			};

			cam1@vcam1 {
				phandle = <0x2d>;

				pins_cmd_dat {
					output-high;
					pinmux = <0x1000>;
					slew-rate = <0x1>;
				};
			};

			cam1@vcam2 {
				phandle = <0x2e>;

				pins_cmd_dat {
					output-low;
					pinmux = <0x1300>;
					slew-rate = <0x1>;
				};
			};

			cam1@vcam3 {
				phandle = <0x2f>;

				pins_cmd_dat {
					output-high;
					pinmux = <0x1300>;
					slew-rate = <0x1>;
				};
			};

			cam2@0 {
				phandle = <0x20>;

				pins_cmd_dat {
					output-low;
					pinmux = <0x3800>;
					slew-rate = <0x1>;
				};
			};

			cam2@1 {
				phandle = <0x21>;

				pins_cmd_dat {
					output-high;
					pinmux = <0x3800>;
					slew-rate = <0x1>;
				};
			};

			cam2@2 {
				phandle = <0x22>;

				pins_cmd_dat {
					output-low;
					pinmux = <0x3700>;
					slew-rate = <0x1>;
				};
			};

			cam2@3 {
				phandle = <0x23>;

				pins_cmd_dat {
					output-high;
					pinmux = <0x3700>;
					slew-rate = <0x1>;
				};
			};

			cam2@vcam0 {
				phandle = <0x30>;

				pins_cmd_dat {
					output-low;
					pinmux = <0x8400>;
					slew-rate = <0x1>;
				};
			};

			cam2@vcam1 {
				phandle = <0x31>;

				pins_cmd_dat {
					output-high;
					pinmux = <0x8400>;
					slew-rate = <0x1>;
				};
			};

			cam2@vcam2 {
				phandle = <0x32>;

				pins_cmd_dat {
					output-low;
					pinmux = <0x8c00>;
					slew-rate = <0x1>;
				};
			};

			cam2@vcam3 {
				phandle = <0x33>;

				pins_cmd_dat {
					output-high;
					pinmux = <0x8c00>;
					slew-rate = <0x1>;
				};
			};

			cam3@0 {
				phandle = <0x24>;

				pins_cmd_dat {
					output-low;
					pinmux = <0x3a00>;
					slew-rate = <0x1>;
				};
			};

			cam3@1 {
				phandle = <0x25>;

				pins_cmd_dat {
					output-high;
					pinmux = <0x3a00>;
					slew-rate = <0x1>;
				};
			};

			cam3@2 {
				phandle = <0x26>;

				pins_cmd_dat {
					output-low;
					pinmux = <0x3900>;
					slew-rate = <0x1>;
				};
			};

			cam3@3 {
				phandle = <0x27>;

				pins_cmd_dat {
					output-high;
					pinmux = <0x3900>;
					slew-rate = <0x1>;
				};
			};

			cam3@vcam0 {
				phandle = <0x34>;

				pins_cmd_dat {
					output-low;
					pinmux = <0x8300>;
					slew-rate = <0x1>;
				};
			};

			cam3@vcam1 {
				phandle = <0x35>;

				pins_cmd_dat {
					output-high;
					pinmux = <0x8300>;
					slew-rate = <0x1>;
				};
			};

			cam3@vcam2 {
				phandle = <0x36>;

				pins_cmd_dat {
					output-low;
					pinmux = <0x1300>;
					slew-rate = <0x1>;
				};
			};

			cam3@vcam3 {
				phandle = <0x37>;

				pins_cmd_dat {
					output-high;
					pinmux = <0x1300>;
					slew-rate = <0x1>;
				};
			};

			camaf@0 {
				phandle = <0x50>;

				pins_cmd_dat {
					output-low;
					pinmux = <0x8800>;
					slew-rate = <0x1>;
				};
			};

			camaf@1 {
				phandle = <0x51>;

				pins_cmd_dat {
					output-high;
					pinmux = <0x8800>;
					slew-rate = <0x1>;
				};
			};

			camdefault {
				phandle = <0x17>;
			};

			camera_pins_cam0_mclk_2ma {
				phandle = <0x39>;

				pins_cmd_dat {
					drive-strength = <0x0>;
					pinmux = <0x3101>;
				};
			};

			camera_pins_cam0_mclk_4ma {
				phandle = <0x3a>;

				pins_cmd_dat {
					drive-strength = <0x1>;
					pinmux = <0x3101>;
				};
			};

			camera_pins_cam0_mclk_6ma {
				phandle = <0x3b>;

				pins_cmd_dat {
					drive-strength = <0x2>;
					pinmux = <0x3101>;
				};
			};

			camera_pins_cam0_mclk_8ma {
				phandle = <0x3c>;

				pins_cmd_dat {
					drive-strength = <0x3>;
					pinmux = <0x3101>;
				};
			};

			camera_pins_cam0_mclk_off {
				phandle = <0x38>;

				pins_cmd_dat {
					drive-strength = <0x1>;
					pinmux = <0x3100>;
				};
			};

			camera_pins_cam1_mclk_2ma {
				phandle = <0x3e>;

				pins_cmd_dat {
					drive-strength = <0x0>;
					pinmux = <0x3401>;
				};
			};

			camera_pins_cam1_mclk_4ma {
				phandle = <0x3f>;

				pins_cmd_dat {
					drive-strength = <0x1>;
					pinmux = <0x3401>;
				};
			};

			camera_pins_cam1_mclk_6ma {
				phandle = <0x40>;

				pins_cmd_dat {
					drive-strength = <0x2>;
					pinmux = <0x3401>;
				};
			};

			camera_pins_cam1_mclk_8ma {
				phandle = <0x41>;

				pins_cmd_dat {
					drive-strength = <0x3>;
					pinmux = <0x3401>;
				};
			};

			camera_pins_cam1_mclk_off {
				phandle = <0x3d>;

				pins_cmd_dat {
					drive-strength = <0x1>;
					pinmux = <0x3400>;
				};
			};

			camera_pins_cam2_mclk_2ma {
				phandle = <0x43>;

				pins_cmd_dat {
					drive-strength = <0x0>;
					pinmux = <0x3201>;
				};
			};

			camera_pins_cam2_mclk_4ma {
				phandle = <0x44>;

				pins_cmd_dat {
					drive-strength = <0x1>;
					pinmux = <0x3201>;
				};
			};

			camera_pins_cam2_mclk_6ma {
				phandle = <0x45>;

				pins_cmd_dat {
					drive-strength = <0x2>;
					pinmux = <0x3201>;
				};
			};

			camera_pins_cam2_mclk_8ma {
				phandle = <0x46>;

				pins_cmd_dat {
					drive-strength = <0x3>;
					pinmux = <0x3201>;
				};
			};

			camera_pins_cam2_mclk_off {
				phandle = <0x42>;

				pins_cmd_dat {
					drive-strength = <0x1>;
					pinmux = <0x3200>;
				};
			};

			camera_pins_cam3_mclk_2ma {
				phandle = <0x48>;

				pins_cmd_dat {
					drive-strength = <0x0>;
					pinmux = <0x3401>;
				};
			};

			camera_pins_cam3_mclk_4ma {
				phandle = <0x49>;

				pins_cmd_dat {
					drive-strength = <0x1>;
					pinmux = <0x3401>;
				};
			};

			camera_pins_cam3_mclk_6ma {
				phandle = <0x4a>;

				pins_cmd_dat {
					drive-strength = <0x2>;
					pinmux = <0x3401>;
				};
			};

			camera_pins_cam3_mclk_8ma {
				phandle = <0x4b>;

				pins_cmd_dat {
					drive-strength = <0x3>;
					pinmux = <0x3401>;
				};
			};

			camera_pins_cam3_mclk_off {
				phandle = <0x47>;

				pins_cmd_dat {
					drive-strength = <0x1>;
					pinmux = <0x3400>;
				};
			};

			mipi_en@0 {
				phandle = <0x4d>;

				pins_cmd_dat {
					output-low;
					pinmux = <0xb200>;
					slew-rate = <0x1>;
				};
			};

			mipi_en@1 {
				phandle = <0x4c>;

				pins_cmd_dat {
					output-high;
					pinmux = <0xb200>;
					slew-rate = <0x1>;
				};
			};

			mipi_sel@0 {
				phandle = <0x4f>;

				pins_cmd_dat {
					output-low;
					pinmux = <0xb300>;
					slew-rate = <0x1>;
				};
			};

			mipi_sel@1 {
				phandle = <0x4e>;

				pins_cmd_dat {
					output-high;
					pinmux = <0xb300>;
					slew-rate = <0x1>;
				};
			};
		};
	};

	fragment@19 {
		target = <0xffffffff>;

		__overlay__ {
			cam0_vcamio-supply = <0xffffffff>;
			cam1_vcamio-supply = <0xffffffff>;
			cam2_vcamio-supply = <0xffffffff>;
			cam3_vcamio-supply = <0xffffffff>;
			pinctrl-0 = <0x17>;
			pinctrl-1 = <0x18>;
			pinctrl-10 = <0x21>;
			pinctrl-11 = <0x22>;
			pinctrl-12 = <0x23>;
			pinctrl-13 = <0x24>;
			pinctrl-14 = <0x25>;
			pinctrl-15 = <0x26>;
			pinctrl-16 = <0x27>;
			pinctrl-17 = <0x28>;
			pinctrl-18 = <0x29>;
			pinctrl-19 = <0x2a>;
			pinctrl-2 = <0x19>;
			pinctrl-20 = <0x2b>;
			pinctrl-21 = <0x2c>;
			pinctrl-22 = <0x2d>;
			pinctrl-23 = <0x2e>;
			pinctrl-24 = <0x2f>;
			pinctrl-25 = <0x30>;
			pinctrl-26 = <0x31>;
			pinctrl-27 = <0x32>;
			pinctrl-28 = <0x33>;
			pinctrl-29 = <0x34>;
			pinctrl-3 = <0x1a>;
			pinctrl-30 = <0x35>;
			pinctrl-31 = <0x36>;
			pinctrl-32 = <0x37>;
			pinctrl-33 = <0x38>;
			pinctrl-34 = <0x39>;
			pinctrl-35 = <0x3a>;
			pinctrl-36 = <0x3b>;
			pinctrl-37 = <0x3c>;
			pinctrl-38 = <0x3d>;
			pinctrl-39 = <0x3e>;
			pinctrl-4 = <0x1b>;
			pinctrl-40 = <0x3f>;
			pinctrl-41 = <0x40>;
			pinctrl-42 = <0x41>;
			pinctrl-43 = <0x42>;
			pinctrl-44 = <0x43>;
			pinctrl-45 = <0x44>;
			pinctrl-46 = <0x45>;
			pinctrl-47 = <0x46>;
			pinctrl-48 = <0x47>;
			pinctrl-49 = <0x48>;
			pinctrl-5 = <0x1c>;
			pinctrl-50 = <0x49>;
			pinctrl-51 = <0x4a>;
			pinctrl-52 = <0x4b>;
			pinctrl-53 = <0x4c>;
			pinctrl-54 = <0x4d>;
			pinctrl-55 = <0x4e>;
			pinctrl-56 = <0x4f>;
			pinctrl-57 = <0x50>;
			pinctrl-58 = <0x51>;
			pinctrl-6 = <0x1d>;
			pinctrl-7 = <0x1e>;
			pinctrl-8 = <0x1f>;
			pinctrl-9 = <0x20>;
			pinctrl-names = "default", "cam0_rst0", "cam0_rst1", "cam0_pnd0", "cam0_pnd1", "cam1_rst0", "cam1_rst1", "cam1_pnd0", "cam1_pnd1", "cam2_rst0", "cam2_rst1", "cam2_pnd0", "cam2_pnd1", "cam3_rst0", "cam3_rst1", "cam3_pnd0", "cam3_pnd1", "cam0_ldo_vcamd_0", "cam0_ldo_vcamd_1", "cam0_ldo_vcama_0", "cam0_ldo_vcama_1", "cam1_ldo_vcamd_0", "cam1_ldo_vcamd_1", "cam1_ldo_vcama_0", "cam1_ldo_vcama_1", "cam2_ldo_vcamd_0", "cam2_ldo_vcamd_1", "cam2_ldo_vcama_0", "cam2_ldo_vcama_1", "cam3_ldo_vcamd_0", "cam3_ldo_vcamd_1", "cam3_ldo_vcama_0", "cam3_ldo_vcama_1", "cam0_mclk_off", "cam0_mclk_2mA", "cam0_mclk_4mA", "cam0_mclk_6mA", "cam0_mclk_8mA", "cam1_mclk_off", "cam1_mclk_2mA", "cam1_mclk_4mA", "cam1_mclk_6mA", "cam1_mclk_8mA", "cam2_mclk_off", "cam2_mclk_2mA", "cam2_mclk_4mA", "cam2_mclk_6mA", "cam2_mclk_8mA", "cam3_mclk_off", "cam3_mclk_2mA", "cam3_mclk_4mA", "cam3_mclk_6mA", "cam3_mclk_8mA", "cam_mipi_switch_en_1", "cam_mipi_switch_en_0", "cam_mipi_switch_sel_1", "cam_mipi_switch_sel_0", "cam_af0", "cam_af1";
			status = "okay";
		};
	};

	fragment@2 {
		target = <0xffffffff>;

		__overlay__ {
			pwr_off_seq = <0x4000002>;
		};
	};

	fragment@20 {
		target = <0xffffffff>;

		__overlay__ {

			camera_eeprom0@50 {
				compatible = "mediatek,camera_eeprom";
				phandle = <0x67>;
				reg = <0x50>;
				status = "okay";
			};
		};
	};

	fragment@21 {
		target = <0xffffffff>;

		__overlay__ {
			compatible = "mediatek,mt6833-mt6359-sound";
			mediatek,audio-codec = <0xffffffff>;
			mediatek,platform = <0xffffffff>;
			mtk_spk_i2s_in = <0x0>;
			mtk_spk_i2s_out = <0x3>;

			mediatek,speaker-codec {
				sound-dai = <0x52>;
			};
		};
	};

	fragment@22 {
		target = <0xffffffff>;

		__overlay__ {

			aw881xx_smartpa@34 {
				#sound-dai-cells = <0x0>;
				compatible = "awinic,aw881xx_smartpa";
				fade-enable = <0x0>;
				irq-gpio = <0xffffffff 0x27 0x0>;
				pa-syn-enable = <0x0>;
				phandle = <0x52>;
				reg = <0x34>;
				reset-gpio = <0xffffffff 0x8b 0x0>;
				status = "okay";
			};
		};
	};

	fragment@23 {
		target = <0xffffffff>;

		__overlay__ {
			gpio-irq = <0x5>;
			gpio-irq-std = <0xffffffff 0x5 0x0>;
			gpio-rst = <0x5c>;
			gpio-rst-std = <0xffffffff 0x5c 0x0>;
		};
	};

	fragment@24 {
		target = <0xffffffff>;

		__overlay__ {
			#address-cells = <0x1>;
			#size-cells = <0x0>;

			fingerprint@0 {
				compatible = "goodix,goodix-fp";
				netlink-event = <0x1e>;
				reg = <0x0>;
				spi-max-frequency = <0x7a1200>;
				status = "okay";
			};
		};
	};

	fragment@25 {
		target = <0xffffffff>;

		__overlay__ {
			fingeer_eint_pin = <0x16>;
			fingeer_eint_pin_std = <0xffffffff 0x16 0x0>;
			pinctrl-0 = <0x53>;
			pinctrl-1 = <0x54>;
			pinctrl-2 = <0x55>;
			pinctrl-3 = <0x56>;
			pinctrl-4 = <0x57>;
			pinctrl-5 = <0x58>;
			pinctrl-6 = <0x59>;
			pinctrl-7 = <0x5a>;
			pinctrl-names = "default", "state_spi_rst_high", "state_spi_rst_low", "state_spi_eint_init", "state_spi_miso_init", "state_spi_mosi_init", "state_spi_cs_init", "state_spi_ck_init";
			status = "okay";
			vfingerprint-supply = <0xffffffff>;
		};
	};

	fragment@26 {
		target = <0xffffffff>;

		__overlay__ {

			state_default {
				phandle = <0x53>;
			};

			state_spi_ck_init {
				phandle = <0x5a>;

				pins_cmd_dat {
					bias-pull-up;
					pinmux = <0x2301>;
					slew-rate = <0x1>;
				};
			};

			state_spi_cs_init {
				phandle = <0x59>;

				pins_cmd_dat {
					bias-pull-up;
					pinmux = <0x2401>;
					slew-rate = <0x1>;
				};
			};

			state_spi_eint_init {
				phandle = <0x56>;

				pins_cmd_dat {
					bias-disable;
					pinmux = <0x1600>;
					slew-rate = <0x0>;
				};
			};

			state_spi_miso_init {
				phandle = <0x57>;

				pins_cmd_dat {
					bias-pull-up;
					pinmux = <0x2601>;
					slew-rate = <0x0>;
				};
			};

			state_spi_mosi_init {
				phandle = <0x58>;

				pins_cmd_dat {
					bias-pull-up;
					pinmux = <0x2501>;
					slew-rate = <0x1>;
				};
			};

			state_spi_rst_high {
				phandle = <0x54>;

				pins_cmd_dat {
					output-high;
					pinmux = <0x1500>;
					slew-rate = <0x1>;
				};
			};

			state_spi_rst_low {
				phandle = <0x55>;

				pins_cmd_dat {
					output-low;
					pinmux = <0x1500>;
					slew-rate = <0x1>;
				};
			};
		};
	};

	fragment@27 {
		target = <0xffffffff>;

		__overlay__ {

			pins_cfg {
				phandle = <0x5c>;

				pins_cmd_dat {
					bias-pull-up;
					pinmux = <0x5200>;
					slew-rate = <0x0>;
				};
			};

			pins_default {
				phandle = <0x5b>;
			};
		};
	};

	fragment@28 {
		target = <0xffffffff>;

		__overlay__ {
			debounce = <0x9 0xfa00>;
			pinctrl-0 = <0x5b>;
			pinctrl-1 = <0x5c>;
			pinctrl-names = "default", "state_eint_as_int";
			reportkey_eint_pin = <0xffffffff 0x52 0x0>;
			status = "okay";
		};
	};

	fragment@29 {
		target = <0xffffffff>;

		__overlay__ {
			battery0_profile_t0 = <0x0 0xabf3 0x340 0x340 0x5af 0xab84 0x340 0x340 0xb5e 0xab1d 0x348 0x348 0x110d 0xaabd 0x348 0x348 0x16bc 0xaa57 0x340 0x340 0x1c6b 0xa9f4 0x344 0x344 0x221a 0xa98a 0x348 0x348 0x27c9 0xa924 0x344 0x344 0x2d78 0xa8b4 0x344 0x344 0x3327 0xa848 0x348 0x348 0x38d6 0xa7d5 0x33c 0x33c 0x3e85 0xa762 0x344 0x344 0x4434 0xa6ed 0x344 0x344 0x49e3 0xa67a 0x344 0x344 0x4f92 0xa601 0x344 0x344 0x5541 0xa58b 0x348 0x348 0x5af0 0xa512 0x344 0x344 0x609f 0xa49c 0x344 0x344 0x664e 0xa41a 0x344 0x344 0x6bfd 0xa39e 0x340 0x340 0x71ac 0xa325 0x34c 0x34c 0x775b 0xa2ac 0x348 0x348 0x7d0a 0xa23a 0x34c 0x34c 0x82b9 0xa1b1 0x348 0x348 0x8868 0xa154 0x350 0x350 0x8e17 0xa0e5 0x350 0x350 0x93c6 0xa078 0x354 0x354 0x9975 0xa00c 0x34c 0x34c 0x9f24 0x9fa2 0x354 0x354 0xa4d3 0x9f36 0x354 0x354 0xaa82 0x9ed0 0x360 0x360 0xb031 0x9e66 0x35c 0x35c 0xb5e0 0x9e03 0x360 0x360 0xbb8f 0x9d9d 0x360 0x360 0xc13e 0x9d3c 0x360 0x360 0xc6ed 0x9cdc 0x370 0x370 0xcc9c 0x9c7f 0x370 0x370 0xd24b 0x9c1c 0x374 0x374 0xd7fa 0x9bb6 0x384 0x384 0xdda9 0x9b43 0x390 0x390 0xe358 0x9ab8 0x39c 0x39c 0xe907 0x9a16 0x3a0 0x3a0 0xeeb6 0x9997 0x398 0x398 0xf467 0x9934 0x378 0x378 0xfa16 0x98dd 0x35c 0x35c 0xffc5 0x988d 0x348 0x348 0x10574 0x9842 0x348 0x348 0x10b23 0x97fe 0x34c 0x34c 0x110d2 0x97ba 0x344 0x344 0x11681 0x9779 0x34c 0x34c 0x11c30 0x973e 0x348 0x348 0x121df 0x96fd 0x344 0x344 0x1278e 0x96c5 0x348 0x348 0x12d3d 0x968d 0x348 0x348 0x132ec 0x965c 0x350 0x350 0x1389b 0x9624 0x350 0x350 0x13e4a 0x95f2 0x34c 0x34c 0x143f9 0x95c4 0x350 0x350 0x149a8 0x9595 0x354 0x354 0x14f57 0x9567 0x34c 0x34c 0x15506 0x953b 0x354 0x354 0x15ab5 0x9513 0x35c 0x35c 0x16064 0x94ee 0x354 0x354 0x16613 0x94c5 0x35c 0x35c 0x16bc2 0x949a 0x360 0x360 0x17171 0x9475 0x368 0x368 0x17720 0x9443 0x364 0x364 0x17ccf 0x9402 0x36c 0x36c 0x1827e 0x93a8 0x36c 0x36c 0x1882d 0x9355 0x36c 0x36c 0x18ddc 0x9317 0x35c 0x35c 0x1938b 0x92df 0x354 0x354 0x1993a 0x92aa 0x350 0x350 0x19ee9 0x9275 0x354 0x354 0x1a498 0x9241 0x354 0x354 0x1aa47 0x920c 0x34c 0x34c 0x1aff6 0x91e0 0x354 0x354 0x1b5a5 0x91b5 0x350 0x350 0x1bb54 0x9177 0x350 0x350 0x1c103 0x9136 0x350 0x350 0x1c6b2 0x90ef 0x354 0x354 0x1cc61 0x90a4 0x350 0x350 0x1d212 0x9066 0x350 0x350 0x1d7c1 0x901f 0x350 0x350 0x1dd70 0x8fd8 0x35c 0x35c 0x1e31f 0x8f43 0x354 0x354 0x1e8ce 0x8fa0 0x34c 0x34c 0x1ee7d 0x8f9a 0x34c 0x34c 0x1f42c 0x8f90 0x350 0x350 0x1f9db 0x8f78 0x35c 0x35c 0x1ff8c 0x8f3a 0x360 0x360 0x2053b 0x8e4b 0x368 0x368 0x20aea 0x8cb2 0x380 0x380 0x21099 0x8a9c 0x36c 0x36c 0x21648 0x87e0 0x36c 0x36c 0x21bf7 0x8415 0x374 0x374 0x221a6 0x7dc3 0x390 0x390 0x22411 0x7926 0x3b8 0x3b8 0x22487 0x7894 0x47c 0x47c>;
			battery0_profile_t0_col = <0x4>;
			battery0_profile_t0_num = <0x63>;
			battery0_profile_t1 = <0x0 0xacad 0x340 0x340 0x5a5 0xac2e 0x340 0x340 0xb4b 0xabc8 0x348 0x348 0x10f3 0xab62 0x348 0x348 0x1699 0xaafe 0x340 0x340 0x1c41 0xaa9e 0x344 0x344 0x21e7 0xaa3b 0x348 0x348 0x278c 0xa9d5 0x344 0x344 0x2d34 0xa971 0x344 0x344 0x32da 0xa908 0x348 0x348 0x387f 0xa89c 0x33c 0x33c 0x3e25 0xa832 0x344 0x344 0x43ca 0xa7bf 0x344 0x344 0x4970 0xa74a 0x344 0x344 0x4f15 0xa6d4 0x344 0x344 0x54bb 0xa661 0x348 0x348 0x5a63 0xa5e8 0x344 0x344 0x600b 0xa56f 0x344 0x344 0x65b1 0xa4f6 0x344 0x344 0x6b59 0xa47a 0x340 0x340 0x7101 0xa405 0x34c 0x34c 0x76a7 0xa38c 0x348 0x348 0x7c4f 0xa316 0x34c 0x34c 0x81f5 0xa29d 0x348 0x348 0x879d 0xa22d 0x350 0x350 0x8d43 0xa1b8 0x350 0x350 0x92e8 0xa145 0x354 0x354 0x988e 0xa0cf 0x34c 0x34c 0x9e33 0xa063 0x354 0x354 0xa3d8 0x9ff3 0x354 0x354 0xa97e 0x9f86 0x360 0x360 0xaf23 0x9f1a 0x35c 0x35c 0xb4cc 0x9eb1 0x360 0x360 0xba71 0x9e47 0x360 0x360 0xc017 0x9de1 0x360 0x360 0xc5bc 0x9d81 0x370 0x370 0xcb62 0x9d1a 0x370 0x370 0xd107 0x9cb7 0x374 0x374 0xd6ac 0x9c5a 0x384 0x384 0xdc52 0x9bfa 0x390 0x390 0xe1fa 0x9b97 0x39c 0x39c 0xe7a0 0x9b27 0x3a0 0x3a0 0xed45 0x9a9f 0x398 0x398 0xf2eb 0x99fb 0x378 0x378 0xf890 0x9963 0x35c 0x35c 0xfe36 0x98ed 0x348 0x348 0x103de 0x9890 0x348 0x348 0x10986 0x983c 0x34c 0x34c 0x10f2f 0x97ef 0x344 0x344 0x114d4 0x97a7 0x34c 0x34c 0x11a7c 0x9763 0x348 0x348 0x12022 0x971f 0x344 0x344 0x125c7 0x96e4 0x348 0x348 0x12b70 0x96a6 0x348 0x348 0x13118 0x966e 0x350 0x350 0x136be 0x9636 0x350 0x350 0x13c63 0x95ff 0x34c 0x34c 0x14209 0x95cd 0x350 0x350 0x147ae 0x959b 0x354 0x354 0x14d56 0x956a 0x34c 0x34c 0x152fc 0x953e 0x354 0x354 0x158a4 0x9513 0x35c 0x35c 0x15e4c 0x94e8 0x354 0x354 0x163f5 0x94bf 0x35c 0x35c 0x1699d 0x949a 0x360 0x360 0x16f43 0x9475 0x368 0x368 0x174e8 0x944d 0x364 0x364 0x17a90 0x9427 0x36c 0x36c 0x18036 0x93ff 0x36c 0x36c 0x185de 0x93d1 0x36c 0x36c 0x18b87 0x938f 0x35c 0x35c 0x1912c 0x9348 0x354 0x354 0x196d4 0x930d 0x350 0x350 0x19c7a 0x92dc 0x354 0x354 0x1a222 0x92a7 0x354 0x354 0x1a7cb 0x926c 0x34c 0x34c 0x1ad70 0x923a 0x354 0x354 0x1b316 0x9209 0x350 0x350 0x1b8bb 0x91dd 0x350 0x350 0x1be63 0x91b2 0x350 0x350 0x1c409 0x9180 0x354 0x354 0x1c9ae 0x913f 0x350 0x350 0x1cf54 0x90f8 0x350 0x350 0x1d4f9 0x90b7 0x350 0x350 0x1da9f 0x9079 0x35c 0x35c 0x1e044 0x9028 0x354 0x354 0x1e5ea 0x8fd1 0x34c 0x34c 0x1eb8f 0x8fb6 0x34c 0x34c 0x1f135 0x8fa9 0x350 0x350 0x1f6dd 0x8f9d 0x35c 0x35c 0x1fc82 0x8f8d 0x360 0x360 0x2022b 0x8f74 0x368 0x368 0x207d0 0x8f43 0x380 0x380 0x20d76 0x8e86 0x36c 0x36c 0x2131b 0x8cf0 0x36c 0x36c 0x218c1 0x8ad7 0x374 0x374 0x21e66 0x8818 0x390 0x390 0x2240b 0x8434 0x3b8 0x3b8 0x229b1 0x7d8b 0x47c 0x47c>;
			battery0_profile_t1_col = <0x4>;
			battery0_profile_t1_num = <0x63>;
			battery0_profile_t2 = <0x0 0xad01 0x33c 0x33c 0x5a8 0xaca1 0x33c 0x33c 0xb4f 0xac37 0x3cc 0x3cc 0x10f7 0xabd1 0x3f4 0x3f4 0x169f 0xab74 0x400 0x400 0x1c46 0xab14 0x404 0x404 0x21ef 0xaab4 0x400 0x400 0x2797 0xaa54 0x404 0x404 0x2d40 0xa9ed 0x3fc 0x3fc 0x32e8 0xa987 0x3fc 0x3fc 0x3891 0xa91b 0x3f8 0x3f8 0x3e39 0xa8ab 0x3f0 0x3f0 0x43e2 0xa83b 0x3f0 0x3f0 0x498a 0xa7c3 0x3e8 0x3e8 0x4f33 0xa750 0x3e8 0x3e8 0x54db 0xa6d7 0x3e4 0x3e4 0x5a84 0xa65e 0x3e0 0x3e0 0x602c 0xa5e8 0x3e0 0x3e0 0x65d5 0xa56c 0x3e0 0x3e0 0x6b7d 0xa4f3 0x3e4 0x3e4 0x7124 0xa47a 0x3dc 0x3dc 0x76cd 0xa401 0x3d8 0x3d8 0x7c75 0xa38c 0x3dc 0x3dc 0x821e 0xa310 0x3d4 0x3d4 0x87c6 0xa2a3 0x3a4 0x3a4 0x8d6f 0xa22a 0x3c0 0x3c0 0x9317 0xa1b4 0x3cc 0x3cc 0x98c0 0xa145 0x3c4 0x3c4 0x9e68 0xa0d8 0x384 0x384 0xa410 0xa069 0x3b4 0x3b4 0xa9b8 0x9ff3 0x3e4 0x3e4 0xaf60 0x9f8d 0x39c 0x39c 0xb507 0x9f20 0x3b8 0x3b8 0xbaaf 0x9eba 0x3b8 0x3b8 0xc056 0x9e50 0x3b0 0x3b0 0xc5fe 0x9ded 0x3d0 0x3d0 0xcba5 0x9d81 0x3c8 0x3c8 0xd14d 0x9d17 0x3e0 0x3e0 0xd6f4 0x9ca8 0x410 0x410 0xdc9c 0x9c38 0x41c 0x41c 0xe244 0x9bcc 0x420 0x420 0xe7ec 0x9b56 0x3ec 0x3ec 0xed93 0x9ac7 0x3f0 0x3f0 0xf33c 0x9a3c 0x3d4 0x3d4 0xf8e4 0x99b9 0x3b0 0x3b0 0xfe8d 0x9950 0x3a8 0x3a8 0x10435 0x98ed 0x37c 0x37c 0x109dd 0x9896 0x398 0x398 0x10f86 0x9845 0x390 0x390 0x1152e 0x97fe 0x390 0x390 0x11ad7 0x97b7 0x398 0x398 0x1207f 0x9773 0x3a0 0x3a0 0x12628 0x9735 0x390 0x390 0x12bd0 0x96fd 0x370 0x370 0x13179 0x96bf 0x384 0x384 0x13721 0x968a 0x360 0x360 0x13cca 0x967e 0x3e0 0x3e0 0x14271 0x9636 0x374 0x374 0x14819 0x95ff 0x37c 0x37c 0x14dc0 0x95d0 0x34c 0x34c 0x15368 0x95a8 0x334 0x334 0x15910 0x9576 0x368 0x368 0x15eb9 0x954b 0x34c 0x34c 0x16461 0x9522 0x354 0x354 0x16a09 0x94fd 0x35c 0x35c 0x16fb2 0x94d5 0x368 0x368 0x1755a 0x94b0 0x36c 0x36c 0x17b03 0x948e 0x36c 0x36c 0x180ab 0x9465 0x374 0x374 0x18654 0x943a 0x360 0x360 0x18bfc 0x9412 0x364 0x364 0x191a5 0x93ec 0x35c 0x35c 0x1974d 0x93c7 0x368 0x368 0x19cf6 0x939f 0x388 0x388 0x1a29e 0x935e 0x384 0x384 0x1a847 0x932c 0x368 0x368 0x1adef 0x92f1 0x35c 0x35c 0x1b397 0x92c0 0x35c 0x35c 0x1b93e 0x92ad 0x37c 0x37c 0x1bee6 0x928b 0x398 0x398 0x1c48d 0x9250 0x384 0x384 0x1ca35 0x9222 0x380 0x380 0x1cfdc 0x91be 0x354 0x354 0x1d584 0x9199 0x368 0x368 0x1db2b 0x91a9 0x3e4 0x3e4 0x1e0d3 0x914c 0x3ac 0x3ac 0x1e67a 0x90f2 0x3b0 0x3b0 0x1ec22 0x909e 0x3b0 0x3b0 0x1f1c9 0x9082 0x3b8 0x3b8 0x1f771 0x9070 0x3c4 0x3c4 0x1fd18 0x9060 0x3cc 0x3cc 0x202c0 0x904d 0x3dc 0x3dc 0x20867 0x902e 0x3ec 0x3ec 0x20e0f 0x8ff0 0x408 0x408 0x213b6 0x8f1e 0x410 0x410 0x2195e 0x8d65 0x40c 0x40c 0x21f05 0x8b22 0x430 0x430 0x224ad 0x8818 0x460 0x460 0x22a54 0x83a3 0x4d4 0x4d4>;
			battery0_profile_t2_col = <0x4>;
			battery0_profile_t2_num = <0x63>;
			battery0_profile_t3 = <0x0 0xad20 0x6a0 0x6a0 0x5a8 0xac8e 0x6a0 0x6a0 0xb51 0xac0c 0x6f5 0x6f5 0x10f9 0xab99 0x6f0 0x6f0 0x16a2 0xab2d 0x6dd 0x6dd 0x1c4a 0xaac6 0x6cd 0x6cd 0x21f3 0xaa5d 0x6ba 0x6ba 0x279b 0xa9f7 0x6b5 0x6b5 0x2d44 0xa990 0x6a5 0x6a5 0x32ec 0xa927 0x69b 0x69b 0x3895 0xa8b7 0x686 0x686 0x3e3d 0xa84e 0x683 0x683 0x43e6 0xa7db 0x673 0x673 0x498e 0xa769 0x665 0x665 0x4f37 0xa6f6 0x656 0x656 0x54df 0xa686 0x655 0x655 0x5a86 0xa611 0x64d 0x64d 0x602e 0xa59b 0x63e 0x63e 0x65d6 0xa525 0x633 0x633 0x6b7f 0xa4af 0x62e 0x62e 0x7126 0xa436 0x61e 0x61e 0x76ce 0xa3c3 0x61a 0x61a 0x7c75 0xa34e 0x612 0x612 0x821d 0xa2db 0x610 0x610 0x87c4 0xa268 0x60b 0x60b 0x8d6c 0xa1f6 0x608 0x608 0x9313 0xa183 0x606 0x606 0x98bb 0xa113 0x606 0x606 0x9e62 0xa0a1 0x603 0x603 0xa40a 0xa031 0x606 0x606 0xa9b1 0x9fc4 0x610 0x610 0xaf59 0x9f58 0x60b 0x60b 0xb500 0x9eef 0x616 0x616 0xbaa8 0x9e85 0x62a 0x62a 0xc050 0x9e0f 0x633 0x633 0xc5f8 0x9d96 0x633 0x633 0xcb9f 0x9d1a 0x62e 0x62e 0xd147 0x9c9b 0x61e 0x61e 0xd6ee 0x9c1f 0x610 0x610 0xdc96 0x9b9d 0x5ee 0x5ee 0xe23d 0x9b1b 0x5cb 0x5cb 0xe7e5 0x9a9f 0x5ae 0x5ae 0xed8c 0x9a29 0x595 0x595 0xf334 0x99bd 0x586 0x586 0xf8dc 0x9953 0x576 0x576 0xfe85 0x98f0 0x568 0x568 0x1042d 0x9899 0x563 0x563 0x109d6 0x9845 0x558 0x558 0x10f7e 0x97fb 0x55e 0x55e 0x11527 0x97b1 0x55a 0x55a 0x11acf 0x976c 0x55d 0x55d 0x12078 0x9728 0x558 0x558 0x12620 0x96ea 0x558 0x558 0x12bc9 0x96ac 0x55e 0x55e 0x13171 0x9671 0x558 0x558 0x13719 0x9639 0x562 0x562 0x13cc2 0x9605 0x568 0x568 0x1426a 0x95cd 0x563 0x563 0x14813 0x959e 0x56d 0x56d 0x14dbb 0x9570 0x572 0x572 0x15364 0x953e 0x56d 0x56d 0x1590c 0x9513 0x576 0x576 0x15eb5 0x94e8 0x578 0x578 0x1645d 0x94bc 0x576 0x576 0x16a06 0x9497 0x57b 0x57b 0x16fae 0x9472 0x586 0x586 0x17557 0x944d 0x586 0x586 0x17aff 0x942e 0x58b 0x58b 0x180a7 0x9408 0x585 0x585 0x18650 0x93ec 0x58e 0x58e 0x18bf8 0x93d1 0x590 0x590 0x191a1 0x93b5 0x595 0x595 0x19749 0x939c 0x59a 0x59a 0x19cf2 0x937d 0x59e 0x59e 0x1a29a 0x935b 0x5aa 0x5aa 0x1a843 0x9336 0x5ae 0x5ae 0x1adeb 0x930a 0x5b2 0x5b2 0x1b394 0x92dc 0x5b8 0x5b8 0x1b93c 0x92b0 0x5c6 0x5c6 0x1bee5 0x927c 0x5d6 0x5d6 0x1c48d 0x923d 0x5ed 0x5ed 0x1ca36 0x91f6 0x5fd 0x5fd 0x1cfde 0x91ac 0x616 0x616 0x1d586 0x9168 0x633 0x633 0x1db2f 0x9117 0x656 0x656 0x1e0d7 0x90ba 0x67e 0x67e 0x1e680 0x9066 0x69b 0x69b 0x1ec28 0x903b 0x6d2 0x6d2 0x1f1d1 0x9019 0x70e 0x70e 0x1f779 0x8ff7 0x753 0x753 0x1fd22 0x8fce 0x7a2 0x7a2 0x202ca 0x8fa0 0x815 0x815 0x20873 0x8f49 0x89a 0x89a 0x20e1b 0x8e6a 0x920 0x920 0x213c4 0x8cb8 0x9c5 0x9c5 0x2196c 0x8a65 0xadb 0xadb 0x21f15 0x873b 0xc98 0xc98 0x224bd 0x827f 0xfed 0xfed 0x22728 0x7fa4 0x10ba 0x10ba>;
			battery0_profile_t3_col = <0x4>;
			battery0_profile_t3_num = <0x63>;
			battery0_profile_t4 = <0x0 0xac2b 0x435 0x435 0x5a8 0xabd4 0x435 0x435 0xb4f 0xab1a 0xafd 0xafd 0x10f7 0xaa70 0xb8d 0xb8d 0x169e 0xa9d2 0xb5b 0xb5b 0x1c46 0xa943 0xb25 0xb25 0x21ef 0xa8b7 0xaf2 0xaf2 0x2797 0xa835 0xacb 0xacb 0x2d3f 0xa7b9 0xaa8 0xaa8 0x32e6 0xa73a 0xa85 0xa85 0x388e 0xa6c1 0xa62 0xa62 0x3e35 0xa648 0xa40 0xa40 0x43dd 0xa5cf 0xa26 0xa26 0x4984 0xa55d 0xa13 0xa13 0x4f2c 0xa4e7 0x9fb 0x9fb 0x54d3 0xa471 0x9e6 0x9e6 0x5a7b 0xa401 0x9dd 0x9dd 0x6022 0xa38c 0x9c5 0x9c5 0x65ca 0xa319 0x9ba 0x9ba 0x6b71 0xa2a9 0x9b0 0x9b0 0x7119 0xa23a 0x9a2 0x9a2 0x76c0 0xa1ca 0x99d 0x99d 0x7c68 0xa157 0x992 0x992 0x820f 0xa0e5 0x97a 0x97a 0x87b7 0xa078 0x97a 0x97a 0x8d5e 0xa00c 0x97a 0x97a 0x9306 0x9fa5 0x97a 0x97a 0x98ad 0x9f3c 0x983 0x983 0x9e55 0x9ec6 0x983 0x983 0xa3fc 0x9e4a 0x97a 0x97a 0xa9a4 0x9dcb 0x96b 0x96b 0xaf4b 0x9d49 0x952 0x952 0xb4f3 0x9ccd 0x943 0x943 0xba9a 0x9c4e 0x920 0x920 0xc042 0x9bcf 0x903 0x903 0xc5e9 0x9b56 0x8e5 0x8e5 0xcb91 0x9ae9 0x8d0 0x8d0 0xd138 0x9a80 0x8c8 0x8c8 0xd6e0 0x9a1a 0x8ba 0x8ba 0xdc87 0x99b0 0x8aa 0x8aa 0xe22f 0x994a 0x8a0 0x8a0 0xe7d6 0x98ea 0x886 0x886 0xed7e 0x9890 0x882 0x882 0xf325 0x9839 0x87d 0x87d 0xf8cd 0x97e8 0x876 0x876 0xfe74 0x979b 0x878 0x878 0x1041c 0x9750 0x876 0x876 0x109c3 0x9709 0x87d 0x87d 0x10f6b 0x96c8 0x882 0x882 0x11512 0x9687 0x882 0x882 0x11aba 0x964c 0x890 0x890 0x12061 0x9614 0x89a 0x89a 0x12609 0x95d9 0x89e 0x89e 0x12bb1 0x95a5 0x8a5 0x8a5 0x13159 0x9576 0x8b3 0x8b3 0x13701 0x9541 0x8bd 0x8bd 0x13caa 0x9516 0x8c6 0x8c6 0x14252 0x94eb 0x8cd 0x8cd 0x147fb 0x94c5 0x8e5 0x8e5 0x14da3 0x949a 0x8e5 0x8e5 0x1534c 0x9478 0x8ee 0x8ee 0x158f4 0x945c 0x903 0x903 0x15e9d 0x9440 0x916 0x916 0x16445 0x942a 0x92e 0x92e 0x169ee 0x9412 0x948 0x948 0x16f96 0x93fc 0x962 0x962 0x1753d 0x93e6 0x988 0x988 0x17ae6 0x93cd 0x9a5 0x9a5 0x1808e 0x93b5 0x9ce 0x9ce 0x18637 0x9399 0x9f6 0x9f6 0x18bde 0x9377 0xa1e 0xa1e 0x19186 0x9355 0xa46 0xa46 0x1972d 0x9332 0xa80 0xa80 0x19cd5 0x930a 0xab6 0xab6 0x1a27c 0x92dc 0xaee 0xaee 0x1a824 0x92aa 0xb2a 0xb2a 0x1adcb 0x9275 0xb73 0xb73 0x1b373 0x9237 0xbbd 0xbbd 0x1b91a 0x91f6 0xc08 0xc08 0x1bec2 0x91b2 0xc62 0xc62 0x1c469 0x9168 0xcbb 0xcbb 0x1ca11 0x911d 0xd28 0xd28 0x1cfb8 0x90c9 0xd95 0xd95 0x1d560 0x9076 0xe0d 0xe0d 0x1db07 0x902e 0xe96 0xe96 0x1e0af 0x8ff7 0xf36 0xf36 0x1e656 0x8fc5 0xfe3 0xfe3 0x1ebfe 0x8f97 0x10ba 0x10ba 0x1f1a5 0x8f62 0x11bb 0x11bb 0x1f74d 0x8f11 0x12de 0x12de 0x1fcf4 0x8e86 0x144a 0x144a 0x2029c 0x8d6f 0x15f5 0x15f5 0x20843 0x8ba7 0x1860 0x1860 0x20deb 0x891f 0x1c9a 0x1c9a 0x21083 0x87ca 0x1dc3 0x1dc3 0x211ec 0x870d 0x1c9e 0x1c9e 0x212f4 0x867b 0x1bb5 0x1bb5 0x213c8 0x85ff 0x1aee 0x1aee 0x21479 0x8596 0x1a46 0x1a46>;
			battery0_profile_t4_col = <0x4>;
			battery0_profile_t4_num = <0x63>;
		};
	};

	fragment@3 {
		target = <0xffffffff>;

		__overlay__ {
			mt6360pd,intr_gpio = <0xffffffff 0x9 0x0>;
			mt6360pd,intr_gpio_num = <0x9>;
		};
	};

	fragment@30 {
		target = <0xffffffff>;

		__overlay__ {

			adc_channel@ {
				compatible = "mediatek,adc_channel";
				mediatek,adc_fdd_rf_params_dynamic_custom_ch = <0x2>;
				mediatek,temperature0 = <0x0>;
				mediatek,temperature1 = <0x1>;
				status = "okay";
			};
		};
	};

	fragment@31 {
		target = <0xffffffff>;

		__overlay__ {
			io-channels = <0xffffffff 0x2>;
		};
	};

	fragment@32 {
		target = <0xffffffff>;

		__overlay__ {
			mediatek,clkbuf-config = <0x2 0x1 0x1 0x2 0x0 0x0 0x1>;
			mediatek,clkbuf-controls-for-desense = <0x0 0x4 0x0 0x4 0x0 0x0 0x0>;
			mediatek,clkbuf-output-impedance = <0x6 0x4 0x4 0x4 0x0 0x0 0x4>;
			mediatek,clkbuf-quantity = <0x7>;
			status = "okay";
		};
	};

	fragment@33 {
		target = <0xffffffff>;

		__overlay__ {
			#address-cells = <0x1>;
			#size-cells = <0x0>;
			clock-frequency = <0x61a80>;
			mediatek,use-open-drain;

			cap_touch@5d {
				compatible = "mediatek,cap_touch";
				phandle = <0x68>;
				reg = <0x5d>;
				status = "okay";
			};
		};
	};

	fragment@34 {
		target = <0xffffffff>;

		__overlay__ {
			#address-cells = <0x1>;
			#size-cells = <0x0>;
			clock-frequency = <0x61a80>;
			mediatek,use-open-drain;
		};
	};

	fragment@35 {
		target = <0xffffffff>;

		__overlay__ {
			#address-cells = <0x1>;
			#size-cells = <0x0>;
			clock-frequency = <0x61a80>;
			mediatek,use-open-drain;

			camera_main@3a {
				compatible = "mediatek,camera_main";
				phandle = <0x69>;
				reg = <0x3a>;
				status = "okay";
			};

			camera_main_af@72 {
				compatible = "mediatek,camera_main_af";
				phandle = <0x6a>;
				reg = <0x72>;
				status = "okay";
			};
		};
	};

	fragment@36 {
		target = <0xffffffff>;

		__overlay__ {
			#address-cells = <0x1>;
			#size-cells = <0x0>;
			clock-frequency = <0x61a80>;
			mediatek,use-open-drain;

			nfc@08 {
				compatible = "mediatek,nfc";
				phandle = <0x6b>;
				reg = <0x8>;
				status = "okay";
			};
		};
	};

	fragment@37 {
		target = <0xffffffff>;

		__overlay__ {
			#address-cells = <0x1>;
			#size-cells = <0x0>;
			clock-frequency = <0x61a80>;
			mediatek,use-open-drain;

			camera_sub@2a {
				compatible = "mediatek,camera_sub";
				phandle = <0x6c>;
				reg = <0x2a>;
				status = "okay";
			};

			camera_sub_two@20 {
				compatible = "mediatek,camera_sub_two";
				phandle = <0x6d>;
				reg = <0x20>;
				status = "okay";
			};

			camera_sub_two_af@1c {
				compatible = "mediatek,camera_sub_two_af";
				phandle = <0x6e>;
				reg = <0x1c>;
				status = "okay";
			};
		};
	};

	fragment@38 {
		target = <0xffffffff>;

		__overlay__ {
			#address-cells = <0x1>;
			#size-cells = <0x0>;
			clock-frequency = <0x33e140>;
			mediatek,use-push-pull;

			subpmic@34 {
				compatible = "mediatek,subpmic";
				phandle = <0x6f>;
				reg = <0x34>;
				status = "okay";
			};

			subpmic_ldo@64 {
				compatible = "mediatek,subpmic_ldo";
				phandle = <0x72>;
				reg = <0x64>;
				status = "okay";
			};

			subpmic_pmic@1a {
				compatible = "mediatek,subpmic_pmic";
				phandle = <0x71>;
				reg = <0x1a>;
				status = "okay";
			};

			usb_type_c@4e {
				compatible = "mediatek,usb_type_c";
				phandle = <0x70>;
				reg = <0x4e>;
				status = "okay";
			};
		};
	};

	fragment@39 {
		target = <0xffffffff>;

		__overlay__ {
			#address-cells = <0x1>;
			#size-cells = <0x0>;
			clock-frequency = <0x61a80>;
			mediatek,use-open-drain;

			i2c_lcd_bias@3e {
				compatible = "mediatek,i2c_lcd_bias";
				phandle = <0x73>;
				reg = <0x3e>;
				status = "okay";
			};
		};
	};

	fragment@4 {
		target = <0xffffffff>;

		__overlay__ {
			ac_charger_current = <0x1f47d0>;
			ac_charger_input_current = <0x30d400>;
			charging_host_charger_current = <0x16e360>;
			compatible = "mediatek,lk_charger";
			enable_anime;
			enable_pd20_reset;
			fast_charge_voltage = <0x2dc6c0>;
			max_charger_voltage = <0x632ea0>;
			non_std_ac_charger_current = <0x7a120>;
			pd_charger_current = <0x7a120>;
			power_path_support;
			ta_ac_charger_current = <0x2dc6c0>;
			temp_t1_threshold = <0x0>;
			temp_t3_threshold = <0x2d>;
			temp_t4_threshold = <0x32>;
			usb_charger_current = <0x7a120>;
		};
	};

	fragment@40 {
		target = <0xffffffff>;

		__overlay__ {
			#address-cells = <0x1>;
			#size-cells = <0x0>;
			clock-frequency = <0x61a80>;
			mediatek,use-open-drain;
		};
	};

	fragment@41 {
		target = <0xffffffff>;

		__overlay__ {
			#address-cells = <0x1>;
			#size-cells = <0x0>;
			clock-frequency = <0x61a80>;
			mediatek,use-open-drain;

			camera_main_two@10 {
				compatible = "mediatek,camera_main_two";
				phandle = <0x74>;
				reg = <0x10>;
				status = "okay";
			};

			camera_main_two_af@0c {
				compatible = "mediatek,camera_main_two_af";
				phandle = <0x75>;
				reg = <0xc>;
				status = "okay";
			};
		};
	};

	fragment@42 {
		target = <0xffffffff>;

		__overlay__ {
			#address-cells = <0x1>;
			#size-cells = <0x0>;
			clock-frequency = <0x61a80>;
			mediatek,use-open-drain;
		};
	};

	fragment@43 {
		target = <0xffffffff>;

		__overlay__ {
			GPIO_FDD_BAND_SUPPORT_DETECT_1ST_PIN = <0xffffffff 0x2c 0x0>;
			GPIO_FDD_BAND_SUPPORT_DETECT_2ND_PIN = <0xffffffff 0x2d 0x0>;
			GPIO_FDD_BAND_SUPPORT_DETECT_3RD_PIN = <0xffffffff 0x2e 0x0>;
			GPIO_RF_PWREN_RST_PIN = <0xffffffff 0xaa 0x0>;
			GPIO_SIM1_HOT_PLUG = <0xffffffff 0x4d 0x0>;
			GPIO_SIM1_SCLK = <0xffffffff 0x7c 0x0>;
			GPIO_SIM1_SIO = <0xffffffff 0x7a 0x0>;
			GPIO_SIM1_SRST = <0xffffffff 0x7b 0x0>;
			GPIO_SIM2_SCLK = <0xffffffff 0x77 0x0>;
			GPIO_SIM2_SIO = <0xffffffff 0x79 0x0>;
			GPIO_SIM2_SRST = <0xffffffff 0x78 0x0>;
		};
	};

	fragment@44 {
		target = <0xffffffff>;

		__overlay__ {
			gpio_init_default = <0x0 0x0 0x0 0x0 0x1 0x0 0x1 0x1 0x0 0x0 0x0 0x1 0x1 0x1 0x2 0x0 0x0 0x0 0x1 0x1 0x1 0x3 0x0 0x0 0x0 0x1 0x0 0x1 0x4 0x0 0x0 0x0 0x0 0x0 0x1 0x5 0x0 0x0 0x0 0x1 0x0 0x1 0x6 0x0 0x1 0x0 0x1 0x0 0x1 0x7 0x0 0x1 0x0 0x1 0x0 0x1 0x8 0x7 0x0 0x0 0x1 0x0 0x1 0x9 0x0 0x0 0x0 0x1 0x0 0x1 0xa 0x0 0x0 0x0 0x1 0x1 0x1 0xb 0x0 0x0 0x0 0x1 0x1 0x1 0xc 0x2 0x0 0x0 0x1 0x0 0x1 0xd 0x2 0x0 0x0 0x1 0x0 0x1 0xe 0x0 0x0 0x0 0x1 0x1 0x1 0xf 0x0 0x1 0x0 0x1 0x0 0x1 0x10 0x7 0x0 0x0 0x1 0x0 0x1 0x11 0x7 0x0 0x0 0x1 0x0 0x1 0x12 0x2 0x0 0x0 0x1 0x0 0x1 0x13 0x0 0x1 0x0 0x1 0x0 0x1 0x14 0x7 0x0 0x0 0x1 0x0 0x1 0x15 0x7 0x0 0x0 0x1 0x0 0x1 0x16 0x0 0x0 0x0 0x1 0x0 0x1 0x17 0x0 0x1 0x0 0x1 0x0 0x1 0x18 0x0 0x1 0x0 0x1 0x0 0x1 0x19 0x7 0x0 0x0 0x1 0x0 0x1 0x1a 0x7 0x0 0x0 0x1 0x0 0x1 0x1b 0x1 0x0 0x0 0x0 0x0 0x1 0x1c 0x1 0x0 0x0 0x0 0x0 0x1 0x1d 0x1 0x0 0x0 0x0 0x0 0x1 0x1e 0x1 0x0 0x0 0x1 0x0 0x1 0x1f 0x2 0x0 0x0 0x0 0x0 0x1 0x20 0x2 0x0 0x0 0x0 0x0 0x1 0x21 0x2 0x0 0x0 0x0 0x0 0x1 0x22 0x2 0x0 0x0 0x1 0x0 0x1 0x23 0x4 0x0 0x0 0x1 0x1 0x1 0x24 0x4 0x0 0x0 0x0 0x0 0x1 0x25 0x4 0x0 0x0 0x0 0x0 0x1 0x26 0x4 0x0 0x0 0x1 0x1 0x1 0x27 0x0 0x0 0x0 0x1 0x1 0x1 0x28 0x1 0x0 0x0 0x0 0x0 0x1 0x29 0x1 0x0 0x0 0x0 0x0 0x1 0x2a 0x1 0x0 0x0 0x1 0x0 0x1 0x2b 0x1 0x0 0x0 0x0 0x0 0x1 0x2c 0x0 0x0 0x0 0x1 0x0 0x1 0x2d 0x0 0x0 0x0 0x1 0x0 0x1 0x2e 0x0 0x0 0x0 0x1 0x0 0x1 0x2f 0x0 0x0 0x0 0x1 0x0 0x1 0x30 0x0 0x0 0x0 0x1 0x0 0x1 0x31 0x1 0x0 0x0 0x0 0x0 0x1 0x32 0x1 0x0 0x0 0x0 0x0 0x1 0x33 0x1 0x0 0x0 0x0 0x0 0x1 0x34 0x1 0x0 0x0 0x0 0x0 0x1 0x35 0x0 0x1 0x0 0x1 0x0 0x1 0x36 0x0 0x1 0x0 0x1 0x0 0x1 0x37 0x0 0x1 0x0 0x1 0x0 0x1 0x38 0x0 0x1 0x0 0x1 0x0 0x1 0x39 0x0 0x0 0x0 0x1 0x0 0x1 0x3a 0x0 0x1 0x0 0x1 0x0 0x1 0x3b 0x0 0x1 0x0 0x1 0x0 0x1 0x3c 0x0 0x1 0x0 0x1 0x0 0x1 0x3d 0x1 0x0 0x0 0x1 0x1 0x1 0x3e 0x1 0x0 0x0 0x0 0x0 0x1 0x3f 0x1 0x0 0x0 0x1 0x1 0x1 0x40 0x1 0x0 0x0 0x0 0x0 0x1 0x4d 0x1 0x0 0x0 0x0 0x0 0x1 0x4e 0x0 0x0 0x0 0x1 0x0 0x1 0x4f 0x1 0x0 0x0 0x1 0x1 0x1 0x50 0x1 0x0 0x0 0x1 0x1 0x1 0x51 0x1 0x0 0x0 0x0 0x0 0x1 0x52 0x0 0x0 0x0 0x1 0x1 0x1 0x53 0x1 0x0 0x0 0x0 0x0 0x1 0x54 0x1 0x0 0x0 0x1 0x0 0x1 0x55 0x1 0x0 0x0 0x0 0x0 0x1 0x56 0x1 0x0 0x0 0x0 0x0 0x1 0x57 0x2 0x0 0x0 0x1 0x0 0x1 0x58 0x0 0x0 0x0 0x1 0x0 0x1 0x59 0x0 0x0 0x0 0x1 0x0 0x1 0x5a 0x1 0x0 0x0 0x0 0x0 0x1 0x5b 0x0 0x0 0x0 0x1 0x0 0x1 0x5c 0x0 0x1 0x0 0x1 0x0 0x1 0x5d 0x0 0x1 0x0 0x1 0x0 0x1 0x5e 0x0 0x1 0x0 0x1 0x0 0x1 0x5f 0x1 0x0 0x0 0x1 0x0 0x1 0x60 0x1 0x0 0x0 0x1 0x0 0x1 0x61 0x1 0x0 0x0 0x1 0x1 0x1 0x62 0x1 0x0 0x0 0x1 0x1 0x1 0x63 0x2 0x0 0x0 0x1 0x1 0x1 0x64 0x2 0x0 0x0 0x1 0x1 0x1 0x65 0x1 0x0 0x0 0x1 0x1 0x1 0x66 0x1 0x0 0x0 0x1 0x1 0x1 0x67 0x1 0x0 0x0 0x1 0x1 0x1 0x68 0x1 0x0 0x0 0x1 0x1 0x1 0x69 0x1 0x0 0x0 0x1 0x1 0x1 0x6a 0x1 0x0 0x0 0x1 0x1 0x1 0x6b 0x1 0x0 0x0 0x1 0x1 0x1 0x6c 0x1 0x0 0x0 0x1 0x1 0x1 0x6d 0x1 0x0 0x0 0x1 0x1 0x1 0x6e 0x1 0x0 0x0 0x1 0x1 0x1 0x6f 0x1 0x0 0x0 0x1 0x1 0x1 0x70 0x1 0x0 0x0 0x1 0x1 0x1 0x71 0x1 0x0 0x0 0x1 0x1 0x1 0x72 0x1 0x0 0x0 0x1 0x1 0x1 0x73 0x1 0x0 0x0 0x1 0x0 0x1 0x74 0x1 0x0 0x0 0x1 0x0 0x1 0x75 0x0 0x0 0x0 0x1 0x0 0x1 0x76 0x0 0x0 0x0 0x1 0x0 0x1 0x77 0x1 0x0 0x0 0x0 0x0 0x1 0x78 0x1 0x0 0x0 0x0 0x0 0x1 0x79 0x1 0x0 0x0 0x1 0x1 0x1 0x7a 0x1 0x0 0x0 0x1 0x1 0x1 0x7b 0x1 0x0 0x0 0x0 0x0 0x1 0x7c 0x1 0x0 0x0 0x0 0x0 0x1 0x7d 0x1 0x0 0x0 0x0 0x0 0x1 0x7e 0x1 0x0 0x0 0x1 0x1 0x1 0x7f 0x1 0x0 0x0 0x1 0x1 0x1 0x80 0x1 0x0 0x0 0x1 0x1 0x1 0x81 0x1 0x0 0x0 0x1 0x1 0x1 0x82 0x1 0x0 0x0 0x1 0x1 0x1 0x83 0x0 0x1 0x0 0x1 0x0 0x1 0x84 0x0 0x1 0x0 0x1 0x0 0x1 0x85 0x0 0x1 0x0 0x1 0x0 0x1 0x86 0x0 0x1 0x0 0x1 0x0 0x1 0x87 0x0 0x1 0x0 0x1 0x0 0x1 0x88 0x0 0x1 0x1 0x1 0x0 0x1 0x89 0x0 0x1 0x0 0x1 0x0 0x1 0x8a 0x0 0x1 0x0 0x1 0x0 0x1 0x8b 0x0 0x1 0x0 0x1 0x0 0x1 0x8c 0x0 0x1 0x0 0x1 0x0 0x1 0x8d 0x2 0x0 0x0 0x1 0x0 0x1 0x8e 0x2 0x0 0x0 0x1 0x0 0x1 0x8f 0x1 0x0 0x0 0x0 0x0 0x1 0x90 0x1 0x0 0x0 0x0 0x0 0x1 0x91 0x1 0x0 0x0 0x0 0x0 0x1 0x92 0x1 0x0 0x0 0x0 0x0 0x1 0x93 0x1 0x0 0x0 0x0 0x0 0x1 0x94 0x1 0x0 0x0 0x0 0x0 0x1 0x95 0x1 0x0 0x0 0x1 0x0 0x1 0x96 0x1 0x0 0x0 0x1 0x0 0x1 0x97 0x1 0x0 0x0 0x1 0x0 0x1 0x98 0x1 0x0 0x0 0x1 0x0 0x1 0x99 0x1 0x0 0x0 0x0 0x0 0x1 0x9a 0x1 0x0 0x0 0x0 0x0 0x1 0x9b 0x1 0x0 0x0 0x0 0x0 0x1 0x9c 0x1 0x0 0x0 0x0 0x0 0x1 0x9d 0x1 0x0 0x0 0x0 0x0 0x1 0x9e 0x1 0x0 0x0 0x0 0x0 0x1 0x9f 0x1 0x0 0x0 0x1 0x0 0x1 0xa0 0x1 0x0 0x0 0x1 0x0 0x1 0xa1 0x1 0x0 0x0 0x1 0x0 0x1 0xa2 0x1 0x0 0x0 0x0 0x0 0x0 0xa3 0x1 0x0 0x0 0x1 0x0 0x0 0xa4 0x1 0x0 0x0 0x1 0x0 0x1 0xa5 0x1 0x0 0x0 0x1 0x0 0x1 0xa6 0x1 0x0 0x0 0x0 0x0 0x1 0xa7 0x1 0x0 0x0 0x0 0x0 0x1 0xa8 0x1 0x0 0x0 0x0 0x0 0x1 0xa9 0x1 0x0 0x0 0x0 0x0 0x1 0xaa 0x0 0x1 0x1 0x1 0x0 0x1 0xab 0x1 0x0 0x0 0x0 0x0 0x1 0xac 0x1 0x0 0x0 0x0 0x0 0x1 0xad 0x1 0x0 0x0 0x0 0x0 0x1 0xae 0x1 0x0 0x0 0x0 0x0 0x1 0xaf 0x0 0x1 0x0 0x1 0x0 0x1 0xb0 0x0 0x1 0x0 0x1 0x0 0x1 0xb1 0x1 0x0 0x0 0x0 0x0 0x1 0xb2 0x1 0x0 0x0 0x0 0x0 0x1 0xb3 0x1 0x0 0x0 0x0 0x0 0x1 0xb4 0x1 0x0 0x0 0x0 0x0 0x1 0xb5 0x1 0x0 0x0 0x0 0x0 0x1 0xb6 0x1 0x0 0x0 0x0 0x0 0x1 0xb7 0x1 0x0 0x0 0x0 0x0 0x1 0xb8 0x1 0x0 0x0 0x0 0x0 0x1 0xb9 0x1 0x0 0x0 0x0 0x0 0x1 0xba 0x1 0x0 0x0 0x0 0x0 0x1 0xbb 0x1 0x0 0x0 0x0 0x0 0x1 0xbc 0x1 0x0 0x0 0x0 0x0 0x0 0xbd 0x1 0x0 0x0 0x1 0x0 0x0 0xbe 0x1 0x0 0x0 0x0 0x0 0x0 0xbf 0x1 0x0 0x0 0x1 0x0 0x0 0xc0 0x0 0x0 0x0 0x1 0x0 0x1 0xc1 0x0 0x0 0x0 0x1 0x0 0x1 0xc2 0x0 0x0 0x0 0x1 0x0 0x1 0xc3 0x0 0x0 0x0 0x1 0x0 0x1 0xc4 0x0 0x0 0x0 0x1 0x0 0x1 0xc5 0x0 0x0 0x0 0x1 0x0 0x1 0xc6 0x0 0x0 0x0 0x1 0x0 0x1 0xc7 0x0 0x0 0x0 0x1 0x0 0x1 0xc8 0x0 0x0 0x0 0x1 0x0 0x1>;
		};
	};

	fragment@45 {
		target = <0xffffffff>;

		__overlay__ {
			deb-gpios = <0xffffffff 0x1 0x0>;
			debounce = <0x7d000>;
			interrupt-parent = <0xffffffff>;
			interrupts = <0x1 0x8>;
			status = "okay";
		};
	};

	fragment@46 {
		target = <0xffffffff>;

		__overlay__ {
			interrupt-parent = <0xffffffff>;
			interrupts = <0x5 0x4>;
			status = "okay";
		};
	};

	fragment@47 {
		target = <0xffffffff>;

		__overlay__ {
			interrupt-parent = <0xffffffff>;
			interrupts = <0xa 0x2>;
			status = "okay";
		};
	};

	fragment@48 {
		target = <0xffffffff>;

		__overlay__ {
			interrupt-parent = <0xffffffff>;
			interrupts = <0xe 0x8>;
			status = "okay";
		};
	};

	fragment@49 {
		target = <0xffffffff>;

		__overlay__ {
			interrupt-parent = <0xffffffff>;
			interrupts = <0x16 0x8>;
			status = "okay";
		};
	};

	fragment@5 {
		target = <0xffffffff>;

		__overlay__ {
			ac_charger_current = <0x231860>;
			ac_charger_input_current = <0xf4240>;
			algorithm_name = "DualSwitchCharging";
			apple_1_0a_charger_current = <0x9eb10>;
			apple_2_1a_charger_current = <0xc3500>;
			battery_cv = <0x43e6d0>;
			bif_cv_under_threshold2 = <0x43e6d0>;
			bif_threshold1 = <0x40d990>;
			bif_threshold2 = <0x419ce0>;
			cable_imp_threshold = <0x2bb>;
			charging_host_charger_current = <0x16e360>;
			chg1_ta_ac_charger_current = <0x231860>;
			chg2_ta_ac_charger_current = <0x231860>;
			compatible = "mediatek,charger";
			dual_polling_ieoc = <0xb71b0>;
			enable_dynamic_mivr;
			enable_min_charge_temp;
			enable_pe_2;
			enable_pe_3;
			enable_pe_4;
			enable_pe_plus;
			enable_type_c;
			high_temp_to_enter_pe40 = <0x27>;
			high_temp_to_leave_pe40 = <0x2e>;
			ibus_err = <0xe>;
			jeita_temp_above_t4_cv = <0x40b280>;
			jeita_temp_below_t0_cv = <0x3da540>;
			jeita_temp_t0_to_t1_cv = <0x3da540>;
			jeita_temp_t1_to_t2_cv = <0x40b280>;
			jeita_temp_t2_to_t3_cv = <0x423920>;
			jeita_temp_t3_to_t4_cv = <0x40b280>;
			low_temp_to_enter_pe40 = <0x10>;
			low_temp_to_leave_pe40 = <0xa>;
			max_charge_temp = <0x32>;
			max_charge_temp_minus_x_degree = <0x2f>;
			max_charger_voltage = <0xc65d40>;
			max_dmivr_charger_current = <0x155cc0>;
			min_charge_temp = <0x0>;
			min_charge_temp_plus_x_degree = <0x6>;
			min_charger_voltage = <0x432380>;
			min_charger_voltage_1 = <0x432380>;
			min_charger_voltage_2 = <0x401640>;
			non_std_ac_charger_current = <0x7a120>;
			pd_ichg_level_threshold = <0xf4240>;
			pd_stop_battery_soc = <0x50>;
			pd_vbus_low_bound = <0x4c4b40>;
			pd_vbus_upper_bound = <0x4c4b40>;
			pe20_ichg_level_threshold = <0xf4240>;
			pe40_dual_charger_chg1_current = <0x1e8480>;
			pe40_dual_charger_chg2_current = <0x1e8480>;
			pe40_dual_charger_input_current = <0x2dc6c0>;
			pe40_r_cable_1a_lower = <0x22f>;
			pe40_r_cable_2a_lower = <0x1a4>;
			pe40_r_cable_3a_lower = <0x117>;
			pe40_single_charger_current = <0x2dc6c0>;
			pe40_single_charger_input_current = <0x2dc6c0>;
			pe40_stop_battery_soc = <0x50>;
			pe_ichg_level_threshold = <0xf4240>;
			power_path_support;
			slave_mivr_diff = <0x186a0>;
			ta_9v_support;
			ta_ac_12v_input_current = <0x30d400>;
			ta_ac_7v_input_current = <0x30d400>;
			ta_ac_9v_input_current = <0x30d400>;
			ta_ac_charger_current = <0x2dc6c0>;
			ta_start_battery_soc = <0x0>;
			ta_stop_battery_soc = <0x55>;
			temp_neg_10_thres = <0x0>;
			temp_t0_thres = <0x0>;
			temp_t0_thres_plus_x_degree = <0x0>;
			temp_t1_thres = <0x0>;
			temp_t1_thres_plus_x_degree = <0x6>;
			temp_t2_thres = <0xa>;
			temp_t2_thres_plus_x_degree = <0x10>;
			temp_t3_thres = <0x2d>;
			temp_t3_thres_minus_x_degree = <0x27>;
			temp_t4_thres = <0x32>;
			temp_t4_thres_minus_x_degree = <0x2f>;
			usb_charger_current = <0x7a120>;
			usb_charger_current_configured = <0x7a120>;
			usb_charger_current_suspend = <0x0>;
			usb_charger_current_unconfigured = <0x11170>;
			vbat_cable_imp_threshold = <0x3b8260>;
			vsys_watt = <0x4c4b40>;
		};
	};

	fragment@50 {
		target = <0xffffffff>;

		__overlay__ {
			interrupt-parent = <0xffffffff>;
			interrupts = <0x52 0x8>;
			status = "okay";
		};
	};

	fragment@51 {
		target = <0xffffffff>;

		__overlay__ {
			interrupt-parent = <0xffffffff>;
			interrupts = <0x54 0x1>;
			status = "okay";
		};
	};

	fragment@52 {
		target = <0xffffffff>;

		__overlay__ {
			compatible = "mediatek,md1_sim1_hot_plug_eint-eint";
			debounce = <0x0 0xc350>;
			dedicated = <0x0 0x0>;
			interrupts = <0x0 0x8>;
			sockettype = <0x0 0x0>;
			src_pin = <0x0 0x1>;
			status = "okay";
		};
	};

	fragment@53 {
		target = <0xffffffff>;

		__overlay__ {
			regulator-default-on = <0x1>;
			regulator-name = "vcamio";
			status = "okay";
		};
	};

	fragment@54 {
		target = <0xffffffff>;

		__overlay__ {
			regulator-default-on = <0x1>;
			regulator-name = "vtp";
			status = "okay";
		};
	};

	fragment@55 {
		target = <0xffffffff>;

		__overlay__ {
			status = "okay";
		};
	};

	fragment@56 {
		target = <0xffffffff>;

		__overlay__ {
			status = "okay";
			vtouch-supply = <0xffffffff>;
		};
	};

	fragment@57 {
		target = <0xffffffff>;

		__overlay__ {
			mediatek,kpd-hw-dl-key0 = <0x0>;
			mediatek,kpd-hw-dl-key1 = <0x1>;
			mediatek,kpd-hw-dl-key2 = <0x8>;
			mediatek,kpd-hw-factory-key = <0x1>;
			mediatek,kpd-hw-init-map = <0x73 0x72 0x0 0x0 0x0 0x0 0x0 0x0 0x0 0x0 0x0 0x0 0x0 0x0 0x0 0x0 0x0 0x0 0x0 0x0 0x0 0x0 0x0 0x0 0x0 0x0 0x0 0x0 0x0 0x0 0x0 0x0 0x0 0x0 0x0 0x0 0x0 0x0 0x0 0x0 0x0 0x0 0x0 0x0 0x0 0x0 0x0 0x0 0x0 0x0 0x0 0x0 0x0 0x0 0x0 0x0 0x0 0x0 0x0 0x0 0x0 0x0 0x0 0x0 0x0 0x0 0x0 0x0 0x0 0x0 0x0 0x0>;
			mediatek,kpd-hw-map-num = <0x48>;
			mediatek,kpd-hw-pwrkey = <0x8>;
			mediatek,kpd-hw-recovery-key = <0x0>;
			mediatek,kpd-hw-rstkey = <0x11>;
			mediatek,kpd-key-debounce = <0x400>;
			mediatek,kpd-pwkey-gpio-din = <0x0>;
			mediatek,kpd-pwrkey-eint-gpio = <0x0>;
			mediatek,kpd-sw-pwrkey = <0x74>;
			mediatek,kpd-sw-rstkey = <0x66>;
			mediatek,kpd-use-extend-type = <0x0>;
			status = "okay";
		};
	};

	fragment@6 {
		target = <0xffffffff>;

		__overlay__ {

			sgm4151x@6b {
				charger_name = "secondary_chg";
				compatible = "mediatek,sgm4151x";
				gpio_sgm4151x_en = <0xffffffff 0x7 0x0>;
				reg = <0x6b>;
				status = "okay";
			};
		};
	};

	fragment@7 {
		target = <0xffffffff>;

		__overlay__ {

			lcd_bias_enn0_gpio {
				phandle = <0x4>;

				pins_cmd_dat {
					output-low;
					pinmux = <0x8a00>;
					slew-rate = <0x1>;
				};
			};

			lcd_bias_enn1_gpio {
				phandle = <0x3>;

				pins_cmd_dat {
					output-high;
					pinmux = <0x8a00>;
					slew-rate = <0x1>;
				};
			};

			lcd_bias_enp0_gpio {
				phandle = <0x2>;

				pins_cmd_dat {
					output-low;
					pinmux = <0x8900>;
					slew-rate = <0x1>;
				};
			};

			lcd_bias_enp1_gpio {
				phandle = <0x1>;

				pins_cmd_dat {
					output-high;
					pinmux = <0x8900>;
					slew-rate = <0x1>;
				};
			};

			lcm_dsi_te {
				phandle = <0x7>;

				pins_cmd_dat {
					pinmux = <0x5401>;
				};
			};

			lcm_rst_out0_gpio {
				phandle = <0x6>;

				pins_cmd_dat {
					output-low;
					pinmux = <0x5600>;
					slew-rate = <0x1>;
				};
			};

			lcm_rst_out1_gpio {
				phandle = <0x5>;

				pins_cmd_dat {
					output-high;
					pinmux = <0x5600>;
					slew-rate = <0x1>;
				};
			};
		};
	};

	fragment@8 {
		target = <0xffffffff>;

		__overlay__ {
			pinctrl-0 = <0x1>;
			pinctrl-1 = <0x2>;
			pinctrl-2 = <0x3>;
			pinctrl-3 = <0x4>;
			pinctrl-4 = <0x5>;
			pinctrl-5 = <0x6>;
			pinctrl-6 = <0x7>;
			pinctrl-names = "lcd_bias_enp1_gpio", "lcd_bias_enp0_gpio", "lcd_bias_enn1_gpio", "lcd_bias_enn0_gpio", "lcm_rst_out1_gpio", "lcm_rst_out0_gpio", "mode_te_te";
			status = "okay";
		};
	};

	fragment@9 {
		target = <0xffffffff>;

		__overlay__ {
			pinctrl-0 = <0x5>;
			pinctrl-1 = <0x6>;
			pinctrl-2 = <0x7>;
			pinctrl-names = "lcm_rst_out1_gpio", "lcm_rst_out0_gpio", "mode_te_te";
			status = "okay";
		};
	};
};
